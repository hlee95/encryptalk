#ifndef INCLUDED_CYFITTERIAR_INC
#define INCLUDED_CYFITTERIAR_INC
    INCLUDE cydeviceiar.inc
    INCLUDE cydeviceiar_trm.inc

/* CE */
CE__0__INTTYPE EQU CYREG_PICU2_INTTYPE2
CE__0__MASK EQU 0x04
CE__0__PC EQU CYREG_PRT2_PC2
CE__0__PORT EQU 2
CE__0__SHIFT EQU 2
CE__AG EQU CYREG_PRT2_AG
CE__AMUX EQU CYREG_PRT2_AMUX
CE__BIE EQU CYREG_PRT2_BIE
CE__BIT_MASK EQU CYREG_PRT2_BIT_MASK
CE__BYP EQU CYREG_PRT2_BYP
CE__CTL EQU CYREG_PRT2_CTL
CE__DM0 EQU CYREG_PRT2_DM0
CE__DM1 EQU CYREG_PRT2_DM1
CE__DM2 EQU CYREG_PRT2_DM2
CE__DR EQU CYREG_PRT2_DR
CE__INP_DIS EQU CYREG_PRT2_INP_DIS
CE__INTTYPE_BASE EQU CYDEV_PICU_INTTYPE_PICU2_BASE
CE__LCD_COM_SEG EQU CYREG_PRT2_LCD_COM_SEG
CE__LCD_EN EQU CYREG_PRT2_LCD_EN
CE__MASK EQU 0x04
CE__PORT EQU 2
CE__PRT EQU CYREG_PRT2_PRT
CE__PRTDSI__CAPS_SEL EQU CYREG_PRT2_CAPS_SEL
CE__PRTDSI__DBL_SYNC_IN EQU CYREG_PRT2_DBL_SYNC_IN
CE__PRTDSI__OE_SEL0 EQU CYREG_PRT2_OE_SEL0
CE__PRTDSI__OE_SEL1 EQU CYREG_PRT2_OE_SEL1
CE__PRTDSI__OUT_SEL0 EQU CYREG_PRT2_OUT_SEL0
CE__PRTDSI__OUT_SEL1 EQU CYREG_PRT2_OUT_SEL1
CE__PRTDSI__SYNC_OUT EQU CYREG_PRT2_SYNC_OUT
CE__PS EQU CYREG_PRT2_PS
CE__SHIFT EQU 2
CE__SLW EQU CYREG_PRT2_SLW

/* CSN */
CSN__0__INTTYPE EQU CYREG_PICU2_INTTYPE7
CSN__0__MASK EQU 0x80
CSN__0__PC EQU CYREG_PRT2_PC7
CSN__0__PORT EQU 2
CSN__0__SHIFT EQU 7
CSN__AG EQU CYREG_PRT2_AG
CSN__AMUX EQU CYREG_PRT2_AMUX
CSN__BIE EQU CYREG_PRT2_BIE
CSN__BIT_MASK EQU CYREG_PRT2_BIT_MASK
CSN__BYP EQU CYREG_PRT2_BYP
CSN__CTL EQU CYREG_PRT2_CTL
CSN__DM0 EQU CYREG_PRT2_DM0
CSN__DM1 EQU CYREG_PRT2_DM1
CSN__DM2 EQU CYREG_PRT2_DM2
CSN__DR EQU CYREG_PRT2_DR
CSN__INP_DIS EQU CYREG_PRT2_INP_DIS
CSN__INTTYPE_BASE EQU CYDEV_PICU_INTTYPE_PICU2_BASE
CSN__LCD_COM_SEG EQU CYREG_PRT2_LCD_COM_SEG
CSN__LCD_EN EQU CYREG_PRT2_LCD_EN
CSN__MASK EQU 0x80
CSN__PORT EQU 2
CSN__PRT EQU CYREG_PRT2_PRT
CSN__PRTDSI__CAPS_SEL EQU CYREG_PRT2_CAPS_SEL
CSN__PRTDSI__DBL_SYNC_IN EQU CYREG_PRT2_DBL_SYNC_IN
CSN__PRTDSI__OE_SEL0 EQU CYREG_PRT2_OE_SEL0
CSN__PRTDSI__OE_SEL1 EQU CYREG_PRT2_OE_SEL1
CSN__PRTDSI__OUT_SEL0 EQU CYREG_PRT2_OUT_SEL0
CSN__PRTDSI__OUT_SEL1 EQU CYREG_PRT2_OUT_SEL1
CSN__PRTDSI__SYNC_OUT EQU CYREG_PRT2_SYNC_OUT
CSN__PS EQU CYREG_PRT2_PS
CSN__SHIFT EQU 7
CSN__SLW EQU CYREG_PRT2_SLW

/* MISO */
MISO__0__INTTYPE EQU CYREG_PICU2_INTTYPE4
MISO__0__MASK EQU 0x10
MISO__0__PC EQU CYREG_PRT2_PC4
MISO__0__PORT EQU 2
MISO__0__SHIFT EQU 4
MISO__AG EQU CYREG_PRT2_AG
MISO__AMUX EQU CYREG_PRT2_AMUX
MISO__BIE EQU CYREG_PRT2_BIE
MISO__BIT_MASK EQU CYREG_PRT2_BIT_MASK
MISO__BYP EQU CYREG_PRT2_BYP
MISO__CTL EQU CYREG_PRT2_CTL
MISO__DM0 EQU CYREG_PRT2_DM0
MISO__DM1 EQU CYREG_PRT2_DM1
MISO__DM2 EQU CYREG_PRT2_DM2
MISO__DR EQU CYREG_PRT2_DR
MISO__INP_DIS EQU CYREG_PRT2_INP_DIS
MISO__INTTYPE_BASE EQU CYDEV_PICU_INTTYPE_PICU2_BASE
MISO__LCD_COM_SEG EQU CYREG_PRT2_LCD_COM_SEG
MISO__LCD_EN EQU CYREG_PRT2_LCD_EN
MISO__MASK EQU 0x10
MISO__PORT EQU 2
MISO__PRT EQU CYREG_PRT2_PRT
MISO__PRTDSI__CAPS_SEL EQU CYREG_PRT2_CAPS_SEL
MISO__PRTDSI__DBL_SYNC_IN EQU CYREG_PRT2_DBL_SYNC_IN
MISO__PRTDSI__OE_SEL0 EQU CYREG_PRT2_OE_SEL0
MISO__PRTDSI__OE_SEL1 EQU CYREG_PRT2_OE_SEL1
MISO__PRTDSI__OUT_SEL0 EQU CYREG_PRT2_OUT_SEL0
MISO__PRTDSI__OUT_SEL1 EQU CYREG_PRT2_OUT_SEL1
MISO__PRTDSI__SYNC_OUT EQU CYREG_PRT2_SYNC_OUT
MISO__PS EQU CYREG_PRT2_PS
MISO__SHIFT EQU 4
MISO__SLW EQU CYREG_PRT2_SLW

/* MOSI */
MOSI__0__INTTYPE EQU CYREG_PICU2_INTTYPE6
MOSI__0__MASK EQU 0x40
MOSI__0__PC EQU CYREG_PRT2_PC6
MOSI__0__PORT EQU 2
MOSI__0__SHIFT EQU 6
MOSI__AG EQU CYREG_PRT2_AG
MOSI__AMUX EQU CYREG_PRT2_AMUX
MOSI__BIE EQU CYREG_PRT2_BIE
MOSI__BIT_MASK EQU CYREG_PRT2_BIT_MASK
MOSI__BYP EQU CYREG_PRT2_BYP
MOSI__CTL EQU CYREG_PRT2_CTL
MOSI__DM0 EQU CYREG_PRT2_DM0
MOSI__DM1 EQU CYREG_PRT2_DM1
MOSI__DM2 EQU CYREG_PRT2_DM2
MOSI__DR EQU CYREG_PRT2_DR
MOSI__INP_DIS EQU CYREG_PRT2_INP_DIS
MOSI__INTTYPE_BASE EQU CYDEV_PICU_INTTYPE_PICU2_BASE
MOSI__LCD_COM_SEG EQU CYREG_PRT2_LCD_COM_SEG
MOSI__LCD_EN EQU CYREG_PRT2_LCD_EN
MOSI__MASK EQU 0x40
MOSI__PORT EQU 2
MOSI__PRT EQU CYREG_PRT2_PRT
MOSI__PRTDSI__CAPS_SEL EQU CYREG_PRT2_CAPS_SEL
MOSI__PRTDSI__DBL_SYNC_IN EQU CYREG_PRT2_DBL_SYNC_IN
MOSI__PRTDSI__OE_SEL0 EQU CYREG_PRT2_OE_SEL0
MOSI__PRTDSI__OE_SEL1 EQU CYREG_PRT2_OE_SEL1
MOSI__PRTDSI__OUT_SEL0 EQU CYREG_PRT2_OUT_SEL0
MOSI__PRTDSI__OUT_SEL1 EQU CYREG_PRT2_OUT_SEL1
MOSI__PRTDSI__SYNC_OUT EQU CYREG_PRT2_SYNC_OUT
MOSI__PS EQU CYREG_PRT2_PS
MOSI__SHIFT EQU 6
MOSI__SLW EQU CYREG_PRT2_SLW

/* Rx_1 */
Rx_1__0__INTTYPE EQU CYREG_PICU1_INTTYPE6
Rx_1__0__MASK EQU 0x40
Rx_1__0__PC EQU CYREG_PRT1_PC6
Rx_1__0__PORT EQU 1
Rx_1__0__SHIFT EQU 6
Rx_1__AG EQU CYREG_PRT1_AG
Rx_1__AMUX EQU CYREG_PRT1_AMUX
Rx_1__BIE EQU CYREG_PRT1_BIE
Rx_1__BIT_MASK EQU CYREG_PRT1_BIT_MASK
Rx_1__BYP EQU CYREG_PRT1_BYP
Rx_1__CTL EQU CYREG_PRT1_CTL
Rx_1__DM0 EQU CYREG_PRT1_DM0
Rx_1__DM1 EQU CYREG_PRT1_DM1
Rx_1__DM2 EQU CYREG_PRT1_DM2
Rx_1__DR EQU CYREG_PRT1_DR
Rx_1__INP_DIS EQU CYREG_PRT1_INP_DIS
Rx_1__INTTYPE_BASE EQU CYDEV_PICU_INTTYPE_PICU1_BASE
Rx_1__LCD_COM_SEG EQU CYREG_PRT1_LCD_COM_SEG
Rx_1__LCD_EN EQU CYREG_PRT1_LCD_EN
Rx_1__MASK EQU 0x40
Rx_1__PORT EQU 1
Rx_1__PRT EQU CYREG_PRT1_PRT
Rx_1__PRTDSI__CAPS_SEL EQU CYREG_PRT1_CAPS_SEL
Rx_1__PRTDSI__DBL_SYNC_IN EQU CYREG_PRT1_DBL_SYNC_IN
Rx_1__PRTDSI__OE_SEL0 EQU CYREG_PRT1_OE_SEL0
Rx_1__PRTDSI__OE_SEL1 EQU CYREG_PRT1_OE_SEL1
Rx_1__PRTDSI__OUT_SEL0 EQU CYREG_PRT1_OUT_SEL0
Rx_1__PRTDSI__OUT_SEL1 EQU CYREG_PRT1_OUT_SEL1
Rx_1__PRTDSI__SYNC_OUT EQU CYREG_PRT1_SYNC_OUT
Rx_1__PS EQU CYREG_PRT1_PS
Rx_1__SHIFT EQU 6
Rx_1__SLW EQU CYREG_PRT1_SLW

/* SCLK */
SCLK__0__INTTYPE EQU CYREG_PICU2_INTTYPE3
SCLK__0__MASK EQU 0x08
SCLK__0__PC EQU CYREG_PRT2_PC3
SCLK__0__PORT EQU 2
SCLK__0__SHIFT EQU 3
SCLK__AG EQU CYREG_PRT2_AG
SCLK__AMUX EQU CYREG_PRT2_AMUX
SCLK__BIE EQU CYREG_PRT2_BIE
SCLK__BIT_MASK EQU CYREG_PRT2_BIT_MASK
SCLK__BYP EQU CYREG_PRT2_BYP
SCLK__CTL EQU CYREG_PRT2_CTL
SCLK__DM0 EQU CYREG_PRT2_DM0
SCLK__DM1 EQU CYREG_PRT2_DM1
SCLK__DM2 EQU CYREG_PRT2_DM2
SCLK__DR EQU CYREG_PRT2_DR
SCLK__INP_DIS EQU CYREG_PRT2_INP_DIS
SCLK__INTTYPE_BASE EQU CYDEV_PICU_INTTYPE_PICU2_BASE
SCLK__LCD_COM_SEG EQU CYREG_PRT2_LCD_COM_SEG
SCLK__LCD_EN EQU CYREG_PRT2_LCD_EN
SCLK__MASK EQU 0x08
SCLK__PORT EQU 2
SCLK__PRT EQU CYREG_PRT2_PRT
SCLK__PRTDSI__CAPS_SEL EQU CYREG_PRT2_CAPS_SEL
SCLK__PRTDSI__DBL_SYNC_IN EQU CYREG_PRT2_DBL_SYNC_IN
SCLK__PRTDSI__OE_SEL0 EQU CYREG_PRT2_OE_SEL0
SCLK__PRTDSI__OE_SEL1 EQU CYREG_PRT2_OE_SEL1
SCLK__PRTDSI__OUT_SEL0 EQU CYREG_PRT2_OUT_SEL0
SCLK__PRTDSI__OUT_SEL1 EQU CYREG_PRT2_OUT_SEL1
SCLK__PRTDSI__SYNC_OUT EQU CYREG_PRT2_SYNC_OUT
SCLK__PS EQU CYREG_PRT2_PS
SCLK__SHIFT EQU 3
SCLK__SLW EQU CYREG_PRT2_SLW

/* Tx_1 */
Tx_1__0__INTTYPE EQU CYREG_PICU1_INTTYPE4
Tx_1__0__MASK EQU 0x10
Tx_1__0__PC EQU CYREG_PRT1_PC4
Tx_1__0__PORT EQU 1
Tx_1__0__SHIFT EQU 4
Tx_1__AG EQU CYREG_PRT1_AG
Tx_1__AMUX EQU CYREG_PRT1_AMUX
Tx_1__BIE EQU CYREG_PRT1_BIE
Tx_1__BIT_MASK EQU CYREG_PRT1_BIT_MASK
Tx_1__BYP EQU CYREG_PRT1_BYP
Tx_1__CTL EQU CYREG_PRT1_CTL
Tx_1__DM0 EQU CYREG_PRT1_DM0
Tx_1__DM1 EQU CYREG_PRT1_DM1
Tx_1__DM2 EQU CYREG_PRT1_DM2
Tx_1__DR EQU CYREG_PRT1_DR
Tx_1__INP_DIS EQU CYREG_PRT1_INP_DIS
Tx_1__INTTYPE_BASE EQU CYDEV_PICU_INTTYPE_PICU1_BASE
Tx_1__LCD_COM_SEG EQU CYREG_PRT1_LCD_COM_SEG
Tx_1__LCD_EN EQU CYREG_PRT1_LCD_EN
Tx_1__MASK EQU 0x10
Tx_1__PORT EQU 1
Tx_1__PRT EQU CYREG_PRT1_PRT
Tx_1__PRTDSI__CAPS_SEL EQU CYREG_PRT1_CAPS_SEL
Tx_1__PRTDSI__DBL_SYNC_IN EQU CYREG_PRT1_DBL_SYNC_IN
Tx_1__PRTDSI__OE_SEL0 EQU CYREG_PRT1_OE_SEL0
Tx_1__PRTDSI__OE_SEL1 EQU CYREG_PRT1_OE_SEL1
Tx_1__PRTDSI__OUT_SEL0 EQU CYREG_PRT1_OUT_SEL0
Tx_1__PRTDSI__OUT_SEL1 EQU CYREG_PRT1_OUT_SEL1
Tx_1__PRTDSI__SYNC_OUT EQU CYREG_PRT1_SYNC_OUT
Tx_1__PS EQU CYREG_PRT1_PS
Tx_1__SHIFT EQU 4
Tx_1__SLW EQU CYREG_PRT1_SLW

/* Pin_1 */
Pin_1__0__INTTYPE EQU CYREG_PICU2_INTTYPE1
Pin_1__0__MASK EQU 0x02
Pin_1__0__PC EQU CYREG_PRT2_PC1
Pin_1__0__PORT EQU 2
Pin_1__0__SHIFT EQU 1
Pin_1__AG EQU CYREG_PRT2_AG
Pin_1__AMUX EQU CYREG_PRT2_AMUX
Pin_1__BIE EQU CYREG_PRT2_BIE
Pin_1__BIT_MASK EQU CYREG_PRT2_BIT_MASK
Pin_1__BYP EQU CYREG_PRT2_BYP
Pin_1__CTL EQU CYREG_PRT2_CTL
Pin_1__DM0 EQU CYREG_PRT2_DM0
Pin_1__DM1 EQU CYREG_PRT2_DM1
Pin_1__DM2 EQU CYREG_PRT2_DM2
Pin_1__DR EQU CYREG_PRT2_DR
Pin_1__INP_DIS EQU CYREG_PRT2_INP_DIS
Pin_1__INTTYPE_BASE EQU CYDEV_PICU_INTTYPE_PICU2_BASE
Pin_1__LCD_COM_SEG EQU CYREG_PRT2_LCD_COM_SEG
Pin_1__LCD_EN EQU CYREG_PRT2_LCD_EN
Pin_1__MASK EQU 0x02
Pin_1__PORT EQU 2
Pin_1__PRT EQU CYREG_PRT2_PRT
Pin_1__PRTDSI__CAPS_SEL EQU CYREG_PRT2_CAPS_SEL
Pin_1__PRTDSI__DBL_SYNC_IN EQU CYREG_PRT2_DBL_SYNC_IN
Pin_1__PRTDSI__OE_SEL0 EQU CYREG_PRT2_OE_SEL0
Pin_1__PRTDSI__OE_SEL1 EQU CYREG_PRT2_OE_SEL1
Pin_1__PRTDSI__OUT_SEL0 EQU CYREG_PRT2_OUT_SEL0
Pin_1__PRTDSI__OUT_SEL1 EQU CYREG_PRT2_OUT_SEL1
Pin_1__PRTDSI__SYNC_OUT EQU CYREG_PRT2_SYNC_OUT
Pin_1__PS EQU CYREG_PRT2_PS
Pin_1__SHIFT EQU 1
Pin_1__SLW EQU CYREG_PRT2_SLW

/* SPIM_1_BSPIM */
SPIM_1_BSPIM_BitCounter__16BIT_CONTROL_AUX_CTL_REG EQU CYREG_B0_UDB08_09_ACTL
SPIM_1_BSPIM_BitCounter__16BIT_CONTROL_CONTROL_REG EQU CYREG_B0_UDB08_09_CTL
SPIM_1_BSPIM_BitCounter__16BIT_CONTROL_COUNT_REG EQU CYREG_B0_UDB08_09_CTL
SPIM_1_BSPIM_BitCounter__16BIT_COUNT_CONTROL_REG EQU CYREG_B0_UDB08_09_CTL
SPIM_1_BSPIM_BitCounter__16BIT_COUNT_COUNT_REG EQU CYREG_B0_UDB08_09_CTL
SPIM_1_BSPIM_BitCounter__16BIT_MASK_MASK_REG EQU CYREG_B0_UDB08_09_MSK
SPIM_1_BSPIM_BitCounter__16BIT_MASK_PERIOD_REG EQU CYREG_B0_UDB08_09_MSK
SPIM_1_BSPIM_BitCounter__16BIT_PERIOD_MASK_REG EQU CYREG_B0_UDB08_09_MSK
SPIM_1_BSPIM_BitCounter__16BIT_PERIOD_PERIOD_REG EQU CYREG_B0_UDB08_09_MSK
SPIM_1_BSPIM_BitCounter__CONTROL_AUX_CTL_REG EQU CYREG_B0_UDB08_ACTL
SPIM_1_BSPIM_BitCounter__CONTROL_REG EQU CYREG_B0_UDB08_CTL
SPIM_1_BSPIM_BitCounter__CONTROL_ST_REG EQU CYREG_B0_UDB08_ST_CTL
SPIM_1_BSPIM_BitCounter__COUNT_REG EQU CYREG_B0_UDB08_CTL
SPIM_1_BSPIM_BitCounter__COUNT_ST_REG EQU CYREG_B0_UDB08_ST_CTL
SPIM_1_BSPIM_BitCounter__MASK_CTL_AUX_CTL_REG EQU CYREG_B0_UDB08_MSK_ACTL
SPIM_1_BSPIM_BitCounter__PER_CTL_AUX_CTL_REG EQU CYREG_B0_UDB08_MSK_ACTL
SPIM_1_BSPIM_BitCounter__PERIOD_REG EQU CYREG_B0_UDB08_MSK
SPIM_1_BSPIM_BitCounter_ST__16BIT_STATUS_AUX_CTL_REG EQU CYREG_B0_UDB08_09_ACTL
SPIM_1_BSPIM_BitCounter_ST__16BIT_STATUS_REG EQU CYREG_B0_UDB08_09_ST
SPIM_1_BSPIM_BitCounter_ST__MASK_REG EQU CYREG_B0_UDB08_MSK
SPIM_1_BSPIM_BitCounter_ST__MASK_ST_AUX_CTL_REG EQU CYREG_B0_UDB08_MSK_ACTL
SPIM_1_BSPIM_BitCounter_ST__PER_ST_AUX_CTL_REG EQU CYREG_B0_UDB08_MSK_ACTL
SPIM_1_BSPIM_BitCounter_ST__STATUS_AUX_CTL_REG EQU CYREG_B0_UDB08_ACTL
SPIM_1_BSPIM_BitCounter_ST__STATUS_CNT_REG EQU CYREG_B0_UDB08_ST_CTL
SPIM_1_BSPIM_BitCounter_ST__STATUS_CONTROL_REG EQU CYREG_B0_UDB08_ST_CTL
SPIM_1_BSPIM_BitCounter_ST__STATUS_REG EQU CYREG_B0_UDB08_ST
SPIM_1_BSPIM_RxStsReg__16BIT_STATUS_AUX_CTL_REG EQU CYREG_B0_UDB11_12_ACTL
SPIM_1_BSPIM_RxStsReg__16BIT_STATUS_REG EQU CYREG_B0_UDB11_12_ST
SPIM_1_BSPIM_RxStsReg__4__MASK EQU 0x10
SPIM_1_BSPIM_RxStsReg__4__POS EQU 4
SPIM_1_BSPIM_RxStsReg__5__MASK EQU 0x20
SPIM_1_BSPIM_RxStsReg__5__POS EQU 5
SPIM_1_BSPIM_RxStsReg__6__MASK EQU 0x40
SPIM_1_BSPIM_RxStsReg__6__POS EQU 6
SPIM_1_BSPIM_RxStsReg__MASK EQU 0x70
SPIM_1_BSPIM_RxStsReg__MASK_REG EQU CYREG_B0_UDB11_MSK
SPIM_1_BSPIM_RxStsReg__STATUS_AUX_CTL_REG EQU CYREG_B0_UDB11_ACTL
SPIM_1_BSPIM_RxStsReg__STATUS_REG EQU CYREG_B0_UDB11_ST
SPIM_1_BSPIM_sR8_Dp_u0__16BIT_A0_REG EQU CYREG_B0_UDB08_09_A0
SPIM_1_BSPIM_sR8_Dp_u0__16BIT_A1_REG EQU CYREG_B0_UDB08_09_A1
SPIM_1_BSPIM_sR8_Dp_u0__16BIT_D0_REG EQU CYREG_B0_UDB08_09_D0
SPIM_1_BSPIM_sR8_Dp_u0__16BIT_D1_REG EQU CYREG_B0_UDB08_09_D1
SPIM_1_BSPIM_sR8_Dp_u0__16BIT_DP_AUX_CTL_REG EQU CYREG_B0_UDB08_09_ACTL
SPIM_1_BSPIM_sR8_Dp_u0__16BIT_F0_REG EQU CYREG_B0_UDB08_09_F0
SPIM_1_BSPIM_sR8_Dp_u0__16BIT_F1_REG EQU CYREG_B0_UDB08_09_F1
SPIM_1_BSPIM_sR8_Dp_u0__A0_A1_REG EQU CYREG_B0_UDB08_A0_A1
SPIM_1_BSPIM_sR8_Dp_u0__A0_REG EQU CYREG_B0_UDB08_A0
SPIM_1_BSPIM_sR8_Dp_u0__A1_REG EQU CYREG_B0_UDB08_A1
SPIM_1_BSPIM_sR8_Dp_u0__D0_D1_REG EQU CYREG_B0_UDB08_D0_D1
SPIM_1_BSPIM_sR8_Dp_u0__D0_REG EQU CYREG_B0_UDB08_D0
SPIM_1_BSPIM_sR8_Dp_u0__D1_REG EQU CYREG_B0_UDB08_D1
SPIM_1_BSPIM_sR8_Dp_u0__DP_AUX_CTL_REG EQU CYREG_B0_UDB08_ACTL
SPIM_1_BSPIM_sR8_Dp_u0__F0_F1_REG EQU CYREG_B0_UDB08_F0_F1
SPIM_1_BSPIM_sR8_Dp_u0__F0_REG EQU CYREG_B0_UDB08_F0
SPIM_1_BSPIM_sR8_Dp_u0__F1_REG EQU CYREG_B0_UDB08_F1
SPIM_1_BSPIM_sR8_Dp_u0__MSK_DP_AUX_CTL_REG EQU CYREG_B0_UDB08_MSK_ACTL
SPIM_1_BSPIM_sR8_Dp_u0__PER_DP_AUX_CTL_REG EQU CYREG_B0_UDB08_MSK_ACTL
SPIM_1_BSPIM_TxStsReg__0__MASK EQU 0x01
SPIM_1_BSPIM_TxStsReg__0__POS EQU 0
SPIM_1_BSPIM_TxStsReg__1__MASK EQU 0x02
SPIM_1_BSPIM_TxStsReg__1__POS EQU 1
SPIM_1_BSPIM_TxStsReg__16BIT_STATUS_AUX_CTL_REG EQU CYREG_B1_UDB08_09_ACTL
SPIM_1_BSPIM_TxStsReg__16BIT_STATUS_REG EQU CYREG_B1_UDB08_09_ST
SPIM_1_BSPIM_TxStsReg__2__MASK EQU 0x04
SPIM_1_BSPIM_TxStsReg__2__POS EQU 2
SPIM_1_BSPIM_TxStsReg__3__MASK EQU 0x08
SPIM_1_BSPIM_TxStsReg__3__POS EQU 3
SPIM_1_BSPIM_TxStsReg__4__MASK EQU 0x10
SPIM_1_BSPIM_TxStsReg__4__POS EQU 4
SPIM_1_BSPIM_TxStsReg__MASK EQU 0x1F
SPIM_1_BSPIM_TxStsReg__MASK_REG EQU CYREG_B1_UDB08_MSK
SPIM_1_BSPIM_TxStsReg__STATUS_AUX_CTL_REG EQU CYREG_B1_UDB08_ACTL
SPIM_1_BSPIM_TxStsReg__STATUS_REG EQU CYREG_B1_UDB08_ST

/* SPIM_1_IntClock */
SPIM_1_IntClock__CFG0 EQU CYREG_CLKDIST_DCFG1_CFG0
SPIM_1_IntClock__CFG1 EQU CYREG_CLKDIST_DCFG1_CFG1
SPIM_1_IntClock__CFG2 EQU CYREG_CLKDIST_DCFG1_CFG2
SPIM_1_IntClock__CFG2_SRC_SEL_MASK EQU 0x07
SPIM_1_IntClock__INDEX EQU 0x01
SPIM_1_IntClock__PM_ACT_CFG EQU CYREG_PM_ACT_CFG2
SPIM_1_IntClock__PM_ACT_MSK EQU 0x02
SPIM_1_IntClock__PM_STBY_CFG EQU CYREG_PM_STBY_CFG2
SPIM_1_IntClock__PM_STBY_MSK EQU 0x02

/* UART_1_BUART */
UART_1_BUART_sRX_RxBitCounter__16BIT_CONTROL_AUX_CTL_REG EQU CYREG_B1_UDB10_11_ACTL
UART_1_BUART_sRX_RxBitCounter__16BIT_CONTROL_CONTROL_REG EQU CYREG_B1_UDB10_11_CTL
UART_1_BUART_sRX_RxBitCounter__16BIT_CONTROL_COUNT_REG EQU CYREG_B1_UDB10_11_CTL
UART_1_BUART_sRX_RxBitCounter__16BIT_COUNT_CONTROL_REG EQU CYREG_B1_UDB10_11_CTL
UART_1_BUART_sRX_RxBitCounter__16BIT_COUNT_COUNT_REG EQU CYREG_B1_UDB10_11_CTL
UART_1_BUART_sRX_RxBitCounter__16BIT_MASK_MASK_REG EQU CYREG_B1_UDB10_11_MSK
UART_1_BUART_sRX_RxBitCounter__16BIT_MASK_PERIOD_REG EQU CYREG_B1_UDB10_11_MSK
UART_1_BUART_sRX_RxBitCounter__16BIT_PERIOD_MASK_REG EQU CYREG_B1_UDB10_11_MSK
UART_1_BUART_sRX_RxBitCounter__16BIT_PERIOD_PERIOD_REG EQU CYREG_B1_UDB10_11_MSK
UART_1_BUART_sRX_RxBitCounter__CONTROL_AUX_CTL_REG EQU CYREG_B1_UDB10_ACTL
UART_1_BUART_sRX_RxBitCounter__CONTROL_REG EQU CYREG_B1_UDB10_CTL
UART_1_BUART_sRX_RxBitCounter__CONTROL_ST_REG EQU CYREG_B1_UDB10_ST_CTL
UART_1_BUART_sRX_RxBitCounter__COUNT_REG EQU CYREG_B1_UDB10_CTL
UART_1_BUART_sRX_RxBitCounter__COUNT_ST_REG EQU CYREG_B1_UDB10_ST_CTL
UART_1_BUART_sRX_RxBitCounter__MASK_CTL_AUX_CTL_REG EQU CYREG_B1_UDB10_MSK_ACTL
UART_1_BUART_sRX_RxBitCounter__PER_CTL_AUX_CTL_REG EQU CYREG_B1_UDB10_MSK_ACTL
UART_1_BUART_sRX_RxBitCounter__PERIOD_REG EQU CYREG_B1_UDB10_MSK
UART_1_BUART_sRX_RxBitCounter_ST__16BIT_STATUS_AUX_CTL_REG EQU CYREG_B1_UDB10_11_ACTL
UART_1_BUART_sRX_RxBitCounter_ST__16BIT_STATUS_REG EQU CYREG_B1_UDB10_11_ST
UART_1_BUART_sRX_RxBitCounter_ST__MASK_REG EQU CYREG_B1_UDB10_MSK
UART_1_BUART_sRX_RxBitCounter_ST__MASK_ST_AUX_CTL_REG EQU CYREG_B1_UDB10_MSK_ACTL
UART_1_BUART_sRX_RxBitCounter_ST__PER_ST_AUX_CTL_REG EQU CYREG_B1_UDB10_MSK_ACTL
UART_1_BUART_sRX_RxBitCounter_ST__STATUS_AUX_CTL_REG EQU CYREG_B1_UDB10_ACTL
UART_1_BUART_sRX_RxBitCounter_ST__STATUS_CNT_REG EQU CYREG_B1_UDB10_ST_CTL
UART_1_BUART_sRX_RxBitCounter_ST__STATUS_CONTROL_REG EQU CYREG_B1_UDB10_ST_CTL
UART_1_BUART_sRX_RxBitCounter_ST__STATUS_REG EQU CYREG_B1_UDB10_ST
UART_1_BUART_sRX_RxShifter_u0__16BIT_A0_REG EQU CYREG_B1_UDB10_11_A0
UART_1_BUART_sRX_RxShifter_u0__16BIT_A1_REG EQU CYREG_B1_UDB10_11_A1
UART_1_BUART_sRX_RxShifter_u0__16BIT_D0_REG EQU CYREG_B1_UDB10_11_D0
UART_1_BUART_sRX_RxShifter_u0__16BIT_D1_REG EQU CYREG_B1_UDB10_11_D1
UART_1_BUART_sRX_RxShifter_u0__16BIT_DP_AUX_CTL_REG EQU CYREG_B1_UDB10_11_ACTL
UART_1_BUART_sRX_RxShifter_u0__16BIT_F0_REG EQU CYREG_B1_UDB10_11_F0
UART_1_BUART_sRX_RxShifter_u0__16BIT_F1_REG EQU CYREG_B1_UDB10_11_F1
UART_1_BUART_sRX_RxShifter_u0__A0_A1_REG EQU CYREG_B1_UDB10_A0_A1
UART_1_BUART_sRX_RxShifter_u0__A0_REG EQU CYREG_B1_UDB10_A0
UART_1_BUART_sRX_RxShifter_u0__A1_REG EQU CYREG_B1_UDB10_A1
UART_1_BUART_sRX_RxShifter_u0__D0_D1_REG EQU CYREG_B1_UDB10_D0_D1
UART_1_BUART_sRX_RxShifter_u0__D0_REG EQU CYREG_B1_UDB10_D0
UART_1_BUART_sRX_RxShifter_u0__D1_REG EQU CYREG_B1_UDB10_D1
UART_1_BUART_sRX_RxShifter_u0__DP_AUX_CTL_REG EQU CYREG_B1_UDB10_ACTL
UART_1_BUART_sRX_RxShifter_u0__F0_F1_REG EQU CYREG_B1_UDB10_F0_F1
UART_1_BUART_sRX_RxShifter_u0__F0_REG EQU CYREG_B1_UDB10_F0
UART_1_BUART_sRX_RxShifter_u0__F1_REG EQU CYREG_B1_UDB10_F1
UART_1_BUART_sRX_RxShifter_u0__MSK_DP_AUX_CTL_REG EQU CYREG_B1_UDB10_MSK_ACTL
UART_1_BUART_sRX_RxShifter_u0__PER_DP_AUX_CTL_REG EQU CYREG_B1_UDB10_MSK_ACTL
UART_1_BUART_sRX_RxSts__16BIT_STATUS_AUX_CTL_REG EQU CYREG_B1_UDB09_10_ACTL
UART_1_BUART_sRX_RxSts__16BIT_STATUS_REG EQU CYREG_B1_UDB09_10_ST
UART_1_BUART_sRX_RxSts__3__MASK EQU 0x08
UART_1_BUART_sRX_RxSts__3__POS EQU 3
UART_1_BUART_sRX_RxSts__4__MASK EQU 0x10
UART_1_BUART_sRX_RxSts__4__POS EQU 4
UART_1_BUART_sRX_RxSts__5__MASK EQU 0x20
UART_1_BUART_sRX_RxSts__5__POS EQU 5
UART_1_BUART_sRX_RxSts__MASK EQU 0x38
UART_1_BUART_sRX_RxSts__MASK_REG EQU CYREG_B1_UDB09_MSK
UART_1_BUART_sRX_RxSts__STATUS_AUX_CTL_REG EQU CYREG_B1_UDB09_ACTL
UART_1_BUART_sRX_RxSts__STATUS_REG EQU CYREG_B1_UDB09_ST
UART_1_BUART_sTX_sCLOCK_TxBitClkGen__16BIT_A0_REG EQU CYREG_B1_UDB08_09_A0
UART_1_BUART_sTX_sCLOCK_TxBitClkGen__16BIT_A1_REG EQU CYREG_B1_UDB08_09_A1
UART_1_BUART_sTX_sCLOCK_TxBitClkGen__16BIT_D0_REG EQU CYREG_B1_UDB08_09_D0
UART_1_BUART_sTX_sCLOCK_TxBitClkGen__16BIT_D1_REG EQU CYREG_B1_UDB08_09_D1
UART_1_BUART_sTX_sCLOCK_TxBitClkGen__16BIT_DP_AUX_CTL_REG EQU CYREG_B1_UDB08_09_ACTL
UART_1_BUART_sTX_sCLOCK_TxBitClkGen__16BIT_F0_REG EQU CYREG_B1_UDB08_09_F0
UART_1_BUART_sTX_sCLOCK_TxBitClkGen__16BIT_F1_REG EQU CYREG_B1_UDB08_09_F1
UART_1_BUART_sTX_sCLOCK_TxBitClkGen__A0_A1_REG EQU CYREG_B1_UDB08_A0_A1
UART_1_BUART_sTX_sCLOCK_TxBitClkGen__A0_REG EQU CYREG_B1_UDB08_A0
UART_1_BUART_sTX_sCLOCK_TxBitClkGen__A1_REG EQU CYREG_B1_UDB08_A1
UART_1_BUART_sTX_sCLOCK_TxBitClkGen__D0_D1_REG EQU CYREG_B1_UDB08_D0_D1
UART_1_BUART_sTX_sCLOCK_TxBitClkGen__D0_REG EQU CYREG_B1_UDB08_D0
UART_1_BUART_sTX_sCLOCK_TxBitClkGen__D1_REG EQU CYREG_B1_UDB08_D1
UART_1_BUART_sTX_sCLOCK_TxBitClkGen__DP_AUX_CTL_REG EQU CYREG_B1_UDB08_ACTL
UART_1_BUART_sTX_sCLOCK_TxBitClkGen__F0_F1_REG EQU CYREG_B1_UDB08_F0_F1
UART_1_BUART_sTX_sCLOCK_TxBitClkGen__F0_REG EQU CYREG_B1_UDB08_F0
UART_1_BUART_sTX_sCLOCK_TxBitClkGen__F1_REG EQU CYREG_B1_UDB08_F1
UART_1_BUART_sTX_TxShifter_u0__16BIT_A0_REG EQU CYREG_B0_UDB10_11_A0
UART_1_BUART_sTX_TxShifter_u0__16BIT_A1_REG EQU CYREG_B0_UDB10_11_A1
UART_1_BUART_sTX_TxShifter_u0__16BIT_D0_REG EQU CYREG_B0_UDB10_11_D0
UART_1_BUART_sTX_TxShifter_u0__16BIT_D1_REG EQU CYREG_B0_UDB10_11_D1
UART_1_BUART_sTX_TxShifter_u0__16BIT_DP_AUX_CTL_REG EQU CYREG_B0_UDB10_11_ACTL
UART_1_BUART_sTX_TxShifter_u0__16BIT_F0_REG EQU CYREG_B0_UDB10_11_F0
UART_1_BUART_sTX_TxShifter_u0__16BIT_F1_REG EQU CYREG_B0_UDB10_11_F1
UART_1_BUART_sTX_TxShifter_u0__A0_A1_REG EQU CYREG_B0_UDB10_A0_A1
UART_1_BUART_sTX_TxShifter_u0__A0_REG EQU CYREG_B0_UDB10_A0
UART_1_BUART_sTX_TxShifter_u0__A1_REG EQU CYREG_B0_UDB10_A1
UART_1_BUART_sTX_TxShifter_u0__D0_D1_REG EQU CYREG_B0_UDB10_D0_D1
UART_1_BUART_sTX_TxShifter_u0__D0_REG EQU CYREG_B0_UDB10_D0
UART_1_BUART_sTX_TxShifter_u0__D1_REG EQU CYREG_B0_UDB10_D1
UART_1_BUART_sTX_TxShifter_u0__DP_AUX_CTL_REG EQU CYREG_B0_UDB10_ACTL
UART_1_BUART_sTX_TxShifter_u0__F0_F1_REG EQU CYREG_B0_UDB10_F0_F1
UART_1_BUART_sTX_TxShifter_u0__F0_REG EQU CYREG_B0_UDB10_F0
UART_1_BUART_sTX_TxShifter_u0__F1_REG EQU CYREG_B0_UDB10_F1
UART_1_BUART_sTX_TxSts__0__MASK EQU 0x01
UART_1_BUART_sTX_TxSts__0__POS EQU 0
UART_1_BUART_sTX_TxSts__1__MASK EQU 0x02
UART_1_BUART_sTX_TxSts__1__POS EQU 1
UART_1_BUART_sTX_TxSts__16BIT_STATUS_AUX_CTL_REG EQU CYREG_B0_UDB10_11_ACTL
UART_1_BUART_sTX_TxSts__16BIT_STATUS_REG EQU CYREG_B0_UDB10_11_ST
UART_1_BUART_sTX_TxSts__2__MASK EQU 0x04
UART_1_BUART_sTX_TxSts__2__POS EQU 2
UART_1_BUART_sTX_TxSts__3__MASK EQU 0x08
UART_1_BUART_sTX_TxSts__3__POS EQU 3
UART_1_BUART_sTX_TxSts__MASK EQU 0x0F
UART_1_BUART_sTX_TxSts__MASK_REG EQU CYREG_B0_UDB10_MSK
UART_1_BUART_sTX_TxSts__STATUS_AUX_CTL_REG EQU CYREG_B0_UDB10_ACTL
UART_1_BUART_sTX_TxSts__STATUS_REG EQU CYREG_B0_UDB10_ST

/* UART_1_IntClock */
UART_1_IntClock__CFG0 EQU CYREG_CLKDIST_DCFG2_CFG0
UART_1_IntClock__CFG1 EQU CYREG_CLKDIST_DCFG2_CFG1
UART_1_IntClock__CFG2 EQU CYREG_CLKDIST_DCFG2_CFG2
UART_1_IntClock__CFG2_SRC_SEL_MASK EQU 0x07
UART_1_IntClock__INDEX EQU 0x02
UART_1_IntClock__PM_ACT_CFG EQU CYREG_PM_ACT_CFG2
UART_1_IntClock__PM_ACT_MSK EQU 0x04
UART_1_IntClock__PM_STBY_CFG EQU CYREG_PM_STBY_CFG2
UART_1_IntClock__PM_STBY_MSK EQU 0x04

/* rx_int */
rx_int__INTC_CLR_EN_REG EQU CYREG_NVIC_CLRENA0
rx_int__INTC_CLR_PD_REG EQU CYREG_NVIC_CLRPEND0
rx_int__INTC_MASK EQU 0x01
rx_int__INTC_NUMBER EQU 0
rx_int__INTC_PRIOR_NUM EQU 7
rx_int__INTC_PRIOR_REG EQU CYREG_NVIC_PRI_0
rx_int__INTC_SET_EN_REG EQU CYREG_NVIC_SETENA0
rx_int__INTC_SET_PD_REG EQU CYREG_NVIC_SETPEND0

/* tx_int */
tx_int__INTC_CLR_EN_REG EQU CYREG_NVIC_CLRENA0
tx_int__INTC_CLR_PD_REG EQU CYREG_NVIC_CLRPEND0
tx_int__INTC_MASK EQU 0x02
tx_int__INTC_NUMBER EQU 1
tx_int__INTC_PRIOR_NUM EQU 7
tx_int__INTC_PRIOR_REG EQU CYREG_NVIC_PRI_1
tx_int__INTC_SET_EN_REG EQU CYREG_NVIC_SETENA0
tx_int__INTC_SET_PD_REG EQU CYREG_NVIC_SETPEND0

/* VDAC8_1_viDAC8 */
VDAC8_1_viDAC8__CR0 EQU CYREG_DAC0_CR0
VDAC8_1_viDAC8__CR1 EQU CYREG_DAC0_CR1
VDAC8_1_viDAC8__D EQU CYREG_DAC0_D
VDAC8_1_viDAC8__PM_ACT_CFG EQU CYREG_PM_ACT_CFG8
VDAC8_1_viDAC8__PM_ACT_MSK EQU 0x01
VDAC8_1_viDAC8__PM_STBY_CFG EQU CYREG_PM_STBY_CFG8
VDAC8_1_viDAC8__PM_STBY_MSK EQU 0x01
VDAC8_1_viDAC8__STROBE EQU CYREG_DAC0_STROBE
VDAC8_1_viDAC8__SW0 EQU CYREG_DAC0_SW0
VDAC8_1_viDAC8__SW2 EQU CYREG_DAC0_SW2
VDAC8_1_viDAC8__SW3 EQU CYREG_DAC0_SW3
VDAC8_1_viDAC8__SW4 EQU CYREG_DAC0_SW4
VDAC8_1_viDAC8__TR EQU CYREG_DAC0_TR
VDAC8_1_viDAC8__TRIM__M1 EQU CYREG_FLSHID_CUST_TABLES_DAC0_M1
VDAC8_1_viDAC8__TRIM__M2 EQU CYREG_FLSHID_CUST_TABLES_DAC0_M2
VDAC8_1_viDAC8__TRIM__M3 EQU CYREG_FLSHID_CUST_TABLES_DAC0_M3
VDAC8_1_viDAC8__TRIM__M4 EQU CYREG_FLSHID_CUST_TABLES_DAC0_M4
VDAC8_1_viDAC8__TRIM__M5 EQU CYREG_FLSHID_CUST_TABLES_DAC0_M5
VDAC8_1_viDAC8__TRIM__M6 EQU CYREG_FLSHID_CUST_TABLES_DAC0_M6
VDAC8_1_viDAC8__TRIM__M7 EQU CYREG_FLSHID_CUST_TABLES_DAC0_M7
VDAC8_1_viDAC8__TRIM__M8 EQU CYREG_FLSHID_CUST_TABLES_DAC0_M8
VDAC8_1_viDAC8__TST EQU CYREG_DAC0_TST

/* ADC_Input */
ADC_Input__0__INTTYPE EQU CYREG_PICU0_INTTYPE7
ADC_Input__0__MASK EQU 0x80
ADC_Input__0__PC EQU CYREG_PRT0_PC7
ADC_Input__0__PORT EQU 0
ADC_Input__0__SHIFT EQU 7
ADC_Input__AG EQU CYREG_PRT0_AG
ADC_Input__AMUX EQU CYREG_PRT0_AMUX
ADC_Input__BIE EQU CYREG_PRT0_BIE
ADC_Input__BIT_MASK EQU CYREG_PRT0_BIT_MASK
ADC_Input__BYP EQU CYREG_PRT0_BYP
ADC_Input__CTL EQU CYREG_PRT0_CTL
ADC_Input__DM0 EQU CYREG_PRT0_DM0
ADC_Input__DM1 EQU CYREG_PRT0_DM1
ADC_Input__DM2 EQU CYREG_PRT0_DM2
ADC_Input__DR EQU CYREG_PRT0_DR
ADC_Input__INP_DIS EQU CYREG_PRT0_INP_DIS
ADC_Input__INTTYPE_BASE EQU CYDEV_PICU_INTTYPE_PICU0_BASE
ADC_Input__LCD_COM_SEG EQU CYREG_PRT0_LCD_COM_SEG
ADC_Input__LCD_EN EQU CYREG_PRT0_LCD_EN
ADC_Input__MASK EQU 0x80
ADC_Input__PORT EQU 0
ADC_Input__PRT EQU CYREG_PRT0_PRT
ADC_Input__PRTDSI__CAPS_SEL EQU CYREG_PRT0_CAPS_SEL
ADC_Input__PRTDSI__DBL_SYNC_IN EQU CYREG_PRT0_DBL_SYNC_IN
ADC_Input__PRTDSI__OE_SEL0 EQU CYREG_PRT0_OE_SEL0
ADC_Input__PRTDSI__OE_SEL1 EQU CYREG_PRT0_OE_SEL1
ADC_Input__PRTDSI__OUT_SEL0 EQU CYREG_PRT0_OUT_SEL0
ADC_Input__PRTDSI__OUT_SEL1 EQU CYREG_PRT0_OUT_SEL1
ADC_Input__PRTDSI__SYNC_OUT EQU CYREG_PRT0_SYNC_OUT
ADC_Input__PS EQU CYREG_PRT0_PS
ADC_Input__SHIFT EQU 7
ADC_Input__SLW EQU CYREG_PRT0_SLW

/* DAC_Output */
DAC_Output__0__INTTYPE EQU CYREG_PICU0_INTTYPE6
DAC_Output__0__MASK EQU 0x40
DAC_Output__0__PC EQU CYREG_PRT0_PC6
DAC_Output__0__PORT EQU 0
DAC_Output__0__SHIFT EQU 6
DAC_Output__AG EQU CYREG_PRT0_AG
DAC_Output__AMUX EQU CYREG_PRT0_AMUX
DAC_Output__BIE EQU CYREG_PRT0_BIE
DAC_Output__BIT_MASK EQU CYREG_PRT0_BIT_MASK
DAC_Output__BYP EQU CYREG_PRT0_BYP
DAC_Output__CTL EQU CYREG_PRT0_CTL
DAC_Output__DM0 EQU CYREG_PRT0_DM0
DAC_Output__DM1 EQU CYREG_PRT0_DM1
DAC_Output__DM2 EQU CYREG_PRT0_DM2
DAC_Output__DR EQU CYREG_PRT0_DR
DAC_Output__INP_DIS EQU CYREG_PRT0_INP_DIS
DAC_Output__INTTYPE_BASE EQU CYDEV_PICU_INTTYPE_PICU0_BASE
DAC_Output__LCD_COM_SEG EQU CYREG_PRT0_LCD_COM_SEG
DAC_Output__LCD_EN EQU CYREG_PRT0_LCD_EN
DAC_Output__MASK EQU 0x40
DAC_Output__PORT EQU 0
DAC_Output__PRT EQU CYREG_PRT0_PRT
DAC_Output__PRTDSI__CAPS_SEL EQU CYREG_PRT0_CAPS_SEL
DAC_Output__PRTDSI__DBL_SYNC_IN EQU CYREG_PRT0_DBL_SYNC_IN
DAC_Output__PRTDSI__OE_SEL0 EQU CYREG_PRT0_OE_SEL0
DAC_Output__PRTDSI__OE_SEL1 EQU CYREG_PRT0_OE_SEL1
DAC_Output__PRTDSI__OUT_SEL0 EQU CYREG_PRT0_OUT_SEL0
DAC_Output__PRTDSI__OUT_SEL1 EQU CYREG_PRT0_OUT_SEL1
DAC_Output__PRTDSI__SYNC_OUT EQU CYREG_PRT0_SYNC_OUT
DAC_Output__PS EQU CYREG_PRT0_PS
DAC_Output__SHIFT EQU 6
DAC_Output__SLW EQU CYREG_PRT0_SLW

/* ADC_DelSig_1_DEC */
ADC_DelSig_1_DEC__COHER EQU CYREG_DEC_COHER
ADC_DelSig_1_DEC__CR EQU CYREG_DEC_CR
ADC_DelSig_1_DEC__DR1 EQU CYREG_DEC_DR1
ADC_DelSig_1_DEC__DR2 EQU CYREG_DEC_DR2
ADC_DelSig_1_DEC__DR2H EQU CYREG_DEC_DR2H
ADC_DelSig_1_DEC__GCOR EQU CYREG_DEC_GCOR
ADC_DelSig_1_DEC__GCORH EQU CYREG_DEC_GCORH
ADC_DelSig_1_DEC__GVAL EQU CYREG_DEC_GVAL
ADC_DelSig_1_DEC__OCOR EQU CYREG_DEC_OCOR
ADC_DelSig_1_DEC__OCORH EQU CYREG_DEC_OCORH
ADC_DelSig_1_DEC__OCORM EQU CYREG_DEC_OCORM
ADC_DelSig_1_DEC__OUTSAMP EQU CYREG_DEC_OUTSAMP
ADC_DelSig_1_DEC__OUTSAMPH EQU CYREG_DEC_OUTSAMPH
ADC_DelSig_1_DEC__OUTSAMPM EQU CYREG_DEC_OUTSAMPM
ADC_DelSig_1_DEC__OUTSAMPS EQU CYREG_DEC_OUTSAMPS
ADC_DelSig_1_DEC__PM_ACT_CFG EQU CYREG_PM_ACT_CFG10
ADC_DelSig_1_DEC__PM_ACT_MSK EQU 0x01
ADC_DelSig_1_DEC__PM_STBY_CFG EQU CYREG_PM_STBY_CFG10
ADC_DelSig_1_DEC__PM_STBY_MSK EQU 0x01
ADC_DelSig_1_DEC__SHIFT1 EQU CYREG_DEC_SHIFT1
ADC_DelSig_1_DEC__SHIFT2 EQU CYREG_DEC_SHIFT2
ADC_DelSig_1_DEC__SR EQU CYREG_DEC_SR
ADC_DelSig_1_DEC__TRIM__M1 EQU CYREG_FLSHID_CUST_TABLES_DEC_M1
ADC_DelSig_1_DEC__TRIM__M2 EQU CYREG_FLSHID_CUST_TABLES_DEC_M2
ADC_DelSig_1_DEC__TRIM__M3 EQU CYREG_FLSHID_CUST_TABLES_DEC_M3
ADC_DelSig_1_DEC__TRIM__M4 EQU CYREG_FLSHID_CUST_TABLES_DEC_M4
ADC_DelSig_1_DEC__TRIM__M5 EQU CYREG_FLSHID_CUST_TABLES_DEC_M5
ADC_DelSig_1_DEC__TRIM__M6 EQU CYREG_FLSHID_CUST_TABLES_DEC_M6
ADC_DelSig_1_DEC__TRIM__M7 EQU CYREG_FLSHID_CUST_TABLES_DEC_M7
ADC_DelSig_1_DEC__TRIM__M8 EQU CYREG_FLSHID_CUST_TABLES_DEC_M8

/* ADC_DelSig_1_DSM */
ADC_DelSig_1_DSM__BUF0 EQU CYREG_DSM0_BUF0
ADC_DelSig_1_DSM__BUF1 EQU CYREG_DSM0_BUF1
ADC_DelSig_1_DSM__BUF2 EQU CYREG_DSM0_BUF2
ADC_DelSig_1_DSM__BUF3 EQU CYREG_DSM0_BUF3
ADC_DelSig_1_DSM__CLK EQU CYREG_DSM0_CLK
ADC_DelSig_1_DSM__CR0 EQU CYREG_DSM0_CR0
ADC_DelSig_1_DSM__CR1 EQU CYREG_DSM0_CR1
ADC_DelSig_1_DSM__CR10 EQU CYREG_DSM0_CR10
ADC_DelSig_1_DSM__CR11 EQU CYREG_DSM0_CR11
ADC_DelSig_1_DSM__CR12 EQU CYREG_DSM0_CR12
ADC_DelSig_1_DSM__CR13 EQU CYREG_DSM0_CR13
ADC_DelSig_1_DSM__CR14 EQU CYREG_DSM0_CR14
ADC_DelSig_1_DSM__CR15 EQU CYREG_DSM0_CR15
ADC_DelSig_1_DSM__CR16 EQU CYREG_DSM0_CR16
ADC_DelSig_1_DSM__CR17 EQU CYREG_DSM0_CR17
ADC_DelSig_1_DSM__CR2 EQU CYREG_DSM0_CR2
ADC_DelSig_1_DSM__CR3 EQU CYREG_DSM0_CR3
ADC_DelSig_1_DSM__CR4 EQU CYREG_DSM0_CR4
ADC_DelSig_1_DSM__CR5 EQU CYREG_DSM0_CR5
ADC_DelSig_1_DSM__CR6 EQU CYREG_DSM0_CR6
ADC_DelSig_1_DSM__CR7 EQU CYREG_DSM0_CR7
ADC_DelSig_1_DSM__CR8 EQU CYREG_DSM0_CR8
ADC_DelSig_1_DSM__CR9 EQU CYREG_DSM0_CR9
ADC_DelSig_1_DSM__DEM0 EQU CYREG_DSM0_DEM0
ADC_DelSig_1_DSM__DEM1 EQU CYREG_DSM0_DEM1
ADC_DelSig_1_DSM__MISC EQU CYREG_DSM0_MISC
ADC_DelSig_1_DSM__OUT0 EQU CYREG_DSM0_OUT0
ADC_DelSig_1_DSM__OUT1 EQU CYREG_DSM0_OUT1
ADC_DelSig_1_DSM__REF0 EQU CYREG_DSM0_REF0
ADC_DelSig_1_DSM__REF1 EQU CYREG_DSM0_REF1
ADC_DelSig_1_DSM__REF2 EQU CYREG_DSM0_REF2
ADC_DelSig_1_DSM__REF3 EQU CYREG_DSM0_REF3
ADC_DelSig_1_DSM__RSVD1 EQU CYREG_DSM0_RSVD1
ADC_DelSig_1_DSM__SW0 EQU CYREG_DSM0_SW0
ADC_DelSig_1_DSM__SW2 EQU CYREG_DSM0_SW2
ADC_DelSig_1_DSM__SW3 EQU CYREG_DSM0_SW3
ADC_DelSig_1_DSM__SW4 EQU CYREG_DSM0_SW4
ADC_DelSig_1_DSM__SW6 EQU CYREG_DSM0_SW6
ADC_DelSig_1_DSM__TR0 EQU CYREG_NPUMP_DSM_TR0
ADC_DelSig_1_DSM__TST0 EQU CYREG_DSM0_TST0
ADC_DelSig_1_DSM__TST1 EQU CYREG_DSM0_TST1

/* ADC_DelSig_1_Ext_CP_Clk */
ADC_DelSig_1_Ext_CP_Clk__CFG0 EQU CYREG_CLKDIST_DCFG0_CFG0
ADC_DelSig_1_Ext_CP_Clk__CFG1 EQU CYREG_CLKDIST_DCFG0_CFG1
ADC_DelSig_1_Ext_CP_Clk__CFG2 EQU CYREG_CLKDIST_DCFG0_CFG2
ADC_DelSig_1_Ext_CP_Clk__CFG2_SRC_SEL_MASK EQU 0x07
ADC_DelSig_1_Ext_CP_Clk__INDEX EQU 0x00
ADC_DelSig_1_Ext_CP_Clk__PM_ACT_CFG EQU CYREG_PM_ACT_CFG2
ADC_DelSig_1_Ext_CP_Clk__PM_ACT_MSK EQU 0x01
ADC_DelSig_1_Ext_CP_Clk__PM_STBY_CFG EQU CYREG_PM_STBY_CFG2
ADC_DelSig_1_Ext_CP_Clk__PM_STBY_MSK EQU 0x01

/* ADC_DelSig_1_IRQ */
ADC_DelSig_1_IRQ__INTC_CLR_EN_REG EQU CYREG_NVIC_CLRENA0
ADC_DelSig_1_IRQ__INTC_CLR_PD_REG EQU CYREG_NVIC_CLRPEND0
ADC_DelSig_1_IRQ__INTC_MASK EQU 0x20000000
ADC_DelSig_1_IRQ__INTC_NUMBER EQU 29
ADC_DelSig_1_IRQ__INTC_PRIOR_NUM EQU 7
ADC_DelSig_1_IRQ__INTC_PRIOR_REG EQU CYREG_NVIC_PRI_29
ADC_DelSig_1_IRQ__INTC_SET_EN_REG EQU CYREG_NVIC_SETENA0
ADC_DelSig_1_IRQ__INTC_SET_PD_REG EQU CYREG_NVIC_SETPEND0

/* ADC_DelSig_1_theACLK */
ADC_DelSig_1_theACLK__CFG0 EQU CYREG_CLKDIST_ACFG0_CFG0
ADC_DelSig_1_theACLK__CFG1 EQU CYREG_CLKDIST_ACFG0_CFG1
ADC_DelSig_1_theACLK__CFG2 EQU CYREG_CLKDIST_ACFG0_CFG2
ADC_DelSig_1_theACLK__CFG2_SRC_SEL_MASK EQU 0x07
ADC_DelSig_1_theACLK__CFG3 EQU CYREG_CLKDIST_ACFG0_CFG3
ADC_DelSig_1_theACLK__CFG3_PHASE_DLY_MASK EQU 0x0F
ADC_DelSig_1_theACLK__INDEX EQU 0x00
ADC_DelSig_1_theACLK__PM_ACT_CFG EQU CYREG_PM_ACT_CFG1
ADC_DelSig_1_theACLK__PM_ACT_MSK EQU 0x01
ADC_DelSig_1_theACLK__PM_STBY_CFG EQU CYREG_PM_STBY_CFG1
ADC_DelSig_1_theACLK__PM_STBY_MSK EQU 0x01

/* Miscellaneous */
BCLK__BUS_CLK__HZ EQU 24000000
BCLK__BUS_CLK__KHZ EQU 24000
BCLK__BUS_CLK__MHZ EQU 24
CYDEV_CHIP_DIE_LEOPARD EQU 1
CYDEV_CHIP_DIE_PANTHER EQU 18
CYDEV_CHIP_DIE_PSOC4A EQU 10
CYDEV_CHIP_DIE_PSOC5LP EQU 17
CYDEV_CHIP_DIE_TMA4 EQU 2
CYDEV_CHIP_DIE_UNKNOWN EQU 0
CYDEV_CHIP_FAMILY_PSOC3 EQU 1
CYDEV_CHIP_FAMILY_PSOC4 EQU 2
CYDEV_CHIP_FAMILY_PSOC5 EQU 3
CYDEV_CHIP_FAMILY_UNKNOWN EQU 0
CYDEV_CHIP_FAMILY_USED EQU CYDEV_CHIP_FAMILY_PSOC5
CYDEV_CHIP_JTAG_ID EQU 0x2E161069
CYDEV_CHIP_MEMBER_3A EQU 1
CYDEV_CHIP_MEMBER_4A EQU 10
CYDEV_CHIP_MEMBER_4C EQU 15
CYDEV_CHIP_MEMBER_4D EQU 6
CYDEV_CHIP_MEMBER_4E EQU 4
CYDEV_CHIP_MEMBER_4F EQU 11
CYDEV_CHIP_MEMBER_4G EQU 2
CYDEV_CHIP_MEMBER_4H EQU 9
CYDEV_CHIP_MEMBER_4I EQU 14
CYDEV_CHIP_MEMBER_4J EQU 7
CYDEV_CHIP_MEMBER_4K EQU 8
CYDEV_CHIP_MEMBER_4L EQU 13
CYDEV_CHIP_MEMBER_4M EQU 12
CYDEV_CHIP_MEMBER_4N EQU 5
CYDEV_CHIP_MEMBER_4U EQU 3
CYDEV_CHIP_MEMBER_5A EQU 17
CYDEV_CHIP_MEMBER_5B EQU 16
CYDEV_CHIP_MEMBER_UNKNOWN EQU 0
CYDEV_CHIP_MEMBER_USED EQU CYDEV_CHIP_MEMBER_5B
CYDEV_CHIP_DIE_EXPECT EQU CYDEV_CHIP_MEMBER_USED
CYDEV_CHIP_DIE_ACTUAL EQU CYDEV_CHIP_DIE_EXPECT
CYDEV_CHIP_REV_LEOPARD_ES1 EQU 0
CYDEV_CHIP_REV_LEOPARD_ES2 EQU 1
CYDEV_CHIP_REV_LEOPARD_ES3 EQU 3
CYDEV_CHIP_REV_LEOPARD_PRODUCTION EQU 3
CYDEV_CHIP_REV_PANTHER_ES0 EQU 0
CYDEV_CHIP_REV_PANTHER_ES1 EQU 1
CYDEV_CHIP_REV_PANTHER_PRODUCTION EQU 1
CYDEV_CHIP_REV_PSOC4A_ES0 EQU 17
CYDEV_CHIP_REV_PSOC4A_PRODUCTION EQU 17
CYDEV_CHIP_REV_PSOC5LP_ES0 EQU 0
CYDEV_CHIP_REV_PSOC5LP_PRODUCTION EQU 0
CYDEV_CHIP_REV_TMA4_ES EQU 17
CYDEV_CHIP_REV_TMA4_ES2 EQU 33
CYDEV_CHIP_REV_TMA4_PRODUCTION EQU 17
CYDEV_CHIP_REVISION_3A_ES1 EQU 0
CYDEV_CHIP_REVISION_3A_ES2 EQU 1
CYDEV_CHIP_REVISION_3A_ES3 EQU 3
CYDEV_CHIP_REVISION_3A_PRODUCTION EQU 3
CYDEV_CHIP_REVISION_4A_ES0 EQU 17
CYDEV_CHIP_REVISION_4A_PRODUCTION EQU 17
CYDEV_CHIP_REVISION_4C_PRODUCTION EQU 0
CYDEV_CHIP_REVISION_4D_PRODUCTION EQU 0
CYDEV_CHIP_REVISION_4E_PRODUCTION EQU 0
CYDEV_CHIP_REVISION_4F_PRODUCTION EQU 0
CYDEV_CHIP_REVISION_4F_PRODUCTION_256DMA EQU 0
CYDEV_CHIP_REVISION_4F_PRODUCTION_256K EQU 0
CYDEV_CHIP_REVISION_4G_ES EQU 17
CYDEV_CHIP_REVISION_4G_ES2 EQU 33
CYDEV_CHIP_REVISION_4G_PRODUCTION EQU 17
CYDEV_CHIP_REVISION_4H_PRODUCTION EQU 0
CYDEV_CHIP_REVISION_4I_PRODUCTION EQU 0
CYDEV_CHIP_REVISION_4J_PRODUCTION EQU 0
CYDEV_CHIP_REVISION_4K_PRODUCTION EQU 0
CYDEV_CHIP_REVISION_4L_PRODUCTION EQU 0
CYDEV_CHIP_REVISION_4M_PRODUCTION EQU 0
CYDEV_CHIP_REVISION_4N_PRODUCTION EQU 0
CYDEV_CHIP_REVISION_4U_PRODUCTION EQU 0
CYDEV_CHIP_REVISION_5A_ES0 EQU 0
CYDEV_CHIP_REVISION_5A_ES1 EQU 1
CYDEV_CHIP_REVISION_5A_PRODUCTION EQU 1
CYDEV_CHIP_REVISION_5B_ES0 EQU 0
CYDEV_CHIP_REVISION_5B_PRODUCTION EQU 0
CYDEV_CHIP_REVISION_USED EQU CYDEV_CHIP_REVISION_5B_PRODUCTION
CYDEV_CHIP_REV_EXPECT EQU CYDEV_CHIP_REVISION_USED
CYDEV_CONFIG_FASTBOOT_ENABLED EQU 1
CYDEV_CONFIG_UNUSED_IO_AllowButWarn EQU 0
CYDEV_CONFIG_UNUSED_IO EQU CYDEV_CONFIG_UNUSED_IO_AllowButWarn
CYDEV_CONFIG_UNUSED_IO_AllowWithInfo EQU 1
CYDEV_CONFIG_UNUSED_IO_Disallowed EQU 2
CYDEV_CONFIGURATION_COMPRESSED EQU 1
CYDEV_CONFIGURATION_DMA EQU 0
CYDEV_CONFIGURATION_ECC EQU 1
CYDEV_CONFIGURATION_IMOENABLED EQU CYDEV_CONFIG_FASTBOOT_ENABLED
CYDEV_CONFIGURATION_MODE_COMPRESSED EQU 0
CYDEV_CONFIGURATION_MODE EQU CYDEV_CONFIGURATION_MODE_COMPRESSED
CYDEV_CONFIGURATION_MODE_DMA EQU 2
CYDEV_CONFIGURATION_MODE_UNCOMPRESSED EQU 1
CYDEV_DEBUG_ENABLE_MASK EQU 0x20
CYDEV_DEBUG_ENABLE_REGISTER EQU CYREG_MLOGIC_DEBUG
CYDEV_DEBUGGING_DPS_Disable EQU 3
CYDEV_DEBUGGING_DPS_JTAG_4 EQU 1
CYDEV_DEBUGGING_DPS_JTAG_5 EQU 0
CYDEV_DEBUGGING_DPS_SWD EQU 2
CYDEV_DEBUGGING_DPS_SWD_SWV EQU 6
CYDEV_DEBUGGING_DPS EQU CYDEV_DEBUGGING_DPS_SWD_SWV
CYDEV_DEBUGGING_ENABLE EQU 1
CYDEV_DEBUGGING_XRES EQU 0
CYDEV_DMA_CHANNELS_AVAILABLE EQU 24
CYDEV_ECC_ENABLE EQU 0
CYDEV_HEAP_SIZE EQU 0x80
CYDEV_INSTRUCT_CACHE_ENABLED EQU 1
CYDEV_INTR_RISING EQU 0x00000003
CYDEV_IS_EXPORTING_CODE EQU 0
CYDEV_IS_IMPORTING_CODE EQU 0
CYDEV_PROJ_TYPE EQU 0
CYDEV_PROJ_TYPE_BOOTLOADER EQU 1
CYDEV_PROJ_TYPE_LAUNCHER EQU 5
CYDEV_PROJ_TYPE_LOADABLE EQU 2
CYDEV_PROJ_TYPE_LOADABLEANDBOOTLOADER EQU 4
CYDEV_PROJ_TYPE_MULTIAPPBOOTLOADER EQU 3
CYDEV_PROJ_TYPE_STANDARD EQU 0
CYDEV_PROTECTION_ENABLE EQU 0
CYDEV_STACK_SIZE EQU 0x0800
CYDEV_USE_BUNDLED_CMSIS EQU 1
CYDEV_VARIABLE_VDDA EQU 0
CYDEV_VDDA_MV EQU 5000
CYDEV_VDDD_MV EQU 5000
CYDEV_VDDIO0_MV EQU 5000
CYDEV_VDDIO1_MV EQU 5000
CYDEV_VDDIO2_MV EQU 5000
CYDEV_VDDIO3_MV EQU 5000
CYDEV_VIO0_MV EQU 5000
CYDEV_VIO1_MV EQU 5000
CYDEV_VIO2_MV EQU 5000
CYDEV_VIO3_MV EQU 5000
CYIPBLOCK_ARM_CM3_VERSION EQU 0
CYIPBLOCK_P3_ANAIF_VERSION EQU 0
CYIPBLOCK_P3_CAN_VERSION EQU 0
CYIPBLOCK_P3_CAPSENSE_VERSION EQU 0
CYIPBLOCK_P3_COMP_VERSION EQU 0
CYIPBLOCK_P3_DECIMATOR_VERSION EQU 0
CYIPBLOCK_P3_DFB_VERSION EQU 0
CYIPBLOCK_P3_DMA_VERSION EQU 0
CYIPBLOCK_P3_DRQ_VERSION EQU 0
CYIPBLOCK_P3_DSM_VERSION EQU 0
CYIPBLOCK_P3_EMIF_VERSION EQU 0
CYIPBLOCK_P3_I2C_VERSION EQU 0
CYIPBLOCK_P3_LCD_VERSION EQU 0
CYIPBLOCK_P3_LPF_VERSION EQU 0
CYIPBLOCK_P3_OPAMP_VERSION EQU 0
CYIPBLOCK_P3_PM_VERSION EQU 0
CYIPBLOCK_P3_SCCT_VERSION EQU 0
CYIPBLOCK_P3_TIMER_VERSION EQU 0
CYIPBLOCK_P3_USB_VERSION EQU 0
CYIPBLOCK_P3_VIDAC_VERSION EQU 0
CYIPBLOCK_P3_VREF_VERSION EQU 0
CYIPBLOCK_S8_GPIO_VERSION EQU 0
CYIPBLOCK_S8_IRQ_VERSION EQU 0
CYIPBLOCK_S8_SAR_VERSION EQU 0
CYIPBLOCK_S8_SIO_VERSION EQU 0
CYIPBLOCK_S8_UDB_VERSION EQU 0
DMA_CHANNELS_USED__MASK0 EQU 0x00000000
CYDEV_BOOTLOADER_ENABLE EQU 0

#endif /* INCLUDED_CYFITTERIAR_INC */
