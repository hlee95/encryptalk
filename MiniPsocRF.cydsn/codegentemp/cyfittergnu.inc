.ifndef INCLUDED_CYFITTERGNU_INC
.set INCLUDED_CYFITTERGNU_INC, 1
.include "cydevicegnu.inc"
.include "cydevicegnu_trm.inc"

/* CE */
.set CE__0__INTTYPE, CYREG_PICU2_INTTYPE2
.set CE__0__MASK, 0x04
.set CE__0__PC, CYREG_PRT2_PC2
.set CE__0__PORT, 2
.set CE__0__SHIFT, 2
.set CE__AG, CYREG_PRT2_AG
.set CE__AMUX, CYREG_PRT2_AMUX
.set CE__BIE, CYREG_PRT2_BIE
.set CE__BIT_MASK, CYREG_PRT2_BIT_MASK
.set CE__BYP, CYREG_PRT2_BYP
.set CE__CTL, CYREG_PRT2_CTL
.set CE__DM0, CYREG_PRT2_DM0
.set CE__DM1, CYREG_PRT2_DM1
.set CE__DM2, CYREG_PRT2_DM2
.set CE__DR, CYREG_PRT2_DR
.set CE__INP_DIS, CYREG_PRT2_INP_DIS
.set CE__INTTYPE_BASE, CYDEV_PICU_INTTYPE_PICU2_BASE
.set CE__LCD_COM_SEG, CYREG_PRT2_LCD_COM_SEG
.set CE__LCD_EN, CYREG_PRT2_LCD_EN
.set CE__MASK, 0x04
.set CE__PORT, 2
.set CE__PRT, CYREG_PRT2_PRT
.set CE__PRTDSI__CAPS_SEL, CYREG_PRT2_CAPS_SEL
.set CE__PRTDSI__DBL_SYNC_IN, CYREG_PRT2_DBL_SYNC_IN
.set CE__PRTDSI__OE_SEL0, CYREG_PRT2_OE_SEL0
.set CE__PRTDSI__OE_SEL1, CYREG_PRT2_OE_SEL1
.set CE__PRTDSI__OUT_SEL0, CYREG_PRT2_OUT_SEL0
.set CE__PRTDSI__OUT_SEL1, CYREG_PRT2_OUT_SEL1
.set CE__PRTDSI__SYNC_OUT, CYREG_PRT2_SYNC_OUT
.set CE__PS, CYREG_PRT2_PS
.set CE__SHIFT, 2
.set CE__SLW, CYREG_PRT2_SLW

/* CSN */
.set CSN__0__INTTYPE, CYREG_PICU2_INTTYPE7
.set CSN__0__MASK, 0x80
.set CSN__0__PC, CYREG_PRT2_PC7
.set CSN__0__PORT, 2
.set CSN__0__SHIFT, 7
.set CSN__AG, CYREG_PRT2_AG
.set CSN__AMUX, CYREG_PRT2_AMUX
.set CSN__BIE, CYREG_PRT2_BIE
.set CSN__BIT_MASK, CYREG_PRT2_BIT_MASK
.set CSN__BYP, CYREG_PRT2_BYP
.set CSN__CTL, CYREG_PRT2_CTL
.set CSN__DM0, CYREG_PRT2_DM0
.set CSN__DM1, CYREG_PRT2_DM1
.set CSN__DM2, CYREG_PRT2_DM2
.set CSN__DR, CYREG_PRT2_DR
.set CSN__INP_DIS, CYREG_PRT2_INP_DIS
.set CSN__INTTYPE_BASE, CYDEV_PICU_INTTYPE_PICU2_BASE
.set CSN__LCD_COM_SEG, CYREG_PRT2_LCD_COM_SEG
.set CSN__LCD_EN, CYREG_PRT2_LCD_EN
.set CSN__MASK, 0x80
.set CSN__PORT, 2
.set CSN__PRT, CYREG_PRT2_PRT
.set CSN__PRTDSI__CAPS_SEL, CYREG_PRT2_CAPS_SEL
.set CSN__PRTDSI__DBL_SYNC_IN, CYREG_PRT2_DBL_SYNC_IN
.set CSN__PRTDSI__OE_SEL0, CYREG_PRT2_OE_SEL0
.set CSN__PRTDSI__OE_SEL1, CYREG_PRT2_OE_SEL1
.set CSN__PRTDSI__OUT_SEL0, CYREG_PRT2_OUT_SEL0
.set CSN__PRTDSI__OUT_SEL1, CYREG_PRT2_OUT_SEL1
.set CSN__PRTDSI__SYNC_OUT, CYREG_PRT2_SYNC_OUT
.set CSN__PS, CYREG_PRT2_PS
.set CSN__SHIFT, 7
.set CSN__SLW, CYREG_PRT2_SLW

/* MISO */
.set MISO__0__INTTYPE, CYREG_PICU2_INTTYPE4
.set MISO__0__MASK, 0x10
.set MISO__0__PC, CYREG_PRT2_PC4
.set MISO__0__PORT, 2
.set MISO__0__SHIFT, 4
.set MISO__AG, CYREG_PRT2_AG
.set MISO__AMUX, CYREG_PRT2_AMUX
.set MISO__BIE, CYREG_PRT2_BIE
.set MISO__BIT_MASK, CYREG_PRT2_BIT_MASK
.set MISO__BYP, CYREG_PRT2_BYP
.set MISO__CTL, CYREG_PRT2_CTL
.set MISO__DM0, CYREG_PRT2_DM0
.set MISO__DM1, CYREG_PRT2_DM1
.set MISO__DM2, CYREG_PRT2_DM2
.set MISO__DR, CYREG_PRT2_DR
.set MISO__INP_DIS, CYREG_PRT2_INP_DIS
.set MISO__INTTYPE_BASE, CYDEV_PICU_INTTYPE_PICU2_BASE
.set MISO__LCD_COM_SEG, CYREG_PRT2_LCD_COM_SEG
.set MISO__LCD_EN, CYREG_PRT2_LCD_EN
.set MISO__MASK, 0x10
.set MISO__PORT, 2
.set MISO__PRT, CYREG_PRT2_PRT
.set MISO__PRTDSI__CAPS_SEL, CYREG_PRT2_CAPS_SEL
.set MISO__PRTDSI__DBL_SYNC_IN, CYREG_PRT2_DBL_SYNC_IN
.set MISO__PRTDSI__OE_SEL0, CYREG_PRT2_OE_SEL0
.set MISO__PRTDSI__OE_SEL1, CYREG_PRT2_OE_SEL1
.set MISO__PRTDSI__OUT_SEL0, CYREG_PRT2_OUT_SEL0
.set MISO__PRTDSI__OUT_SEL1, CYREG_PRT2_OUT_SEL1
.set MISO__PRTDSI__SYNC_OUT, CYREG_PRT2_SYNC_OUT
.set MISO__PS, CYREG_PRT2_PS
.set MISO__SHIFT, 4
.set MISO__SLW, CYREG_PRT2_SLW

/* MOSI */
.set MOSI__0__INTTYPE, CYREG_PICU2_INTTYPE6
.set MOSI__0__MASK, 0x40
.set MOSI__0__PC, CYREG_PRT2_PC6
.set MOSI__0__PORT, 2
.set MOSI__0__SHIFT, 6
.set MOSI__AG, CYREG_PRT2_AG
.set MOSI__AMUX, CYREG_PRT2_AMUX
.set MOSI__BIE, CYREG_PRT2_BIE
.set MOSI__BIT_MASK, CYREG_PRT2_BIT_MASK
.set MOSI__BYP, CYREG_PRT2_BYP
.set MOSI__CTL, CYREG_PRT2_CTL
.set MOSI__DM0, CYREG_PRT2_DM0
.set MOSI__DM1, CYREG_PRT2_DM1
.set MOSI__DM2, CYREG_PRT2_DM2
.set MOSI__DR, CYREG_PRT2_DR
.set MOSI__INP_DIS, CYREG_PRT2_INP_DIS
.set MOSI__INTTYPE_BASE, CYDEV_PICU_INTTYPE_PICU2_BASE
.set MOSI__LCD_COM_SEG, CYREG_PRT2_LCD_COM_SEG
.set MOSI__LCD_EN, CYREG_PRT2_LCD_EN
.set MOSI__MASK, 0x40
.set MOSI__PORT, 2
.set MOSI__PRT, CYREG_PRT2_PRT
.set MOSI__PRTDSI__CAPS_SEL, CYREG_PRT2_CAPS_SEL
.set MOSI__PRTDSI__DBL_SYNC_IN, CYREG_PRT2_DBL_SYNC_IN
.set MOSI__PRTDSI__OE_SEL0, CYREG_PRT2_OE_SEL0
.set MOSI__PRTDSI__OE_SEL1, CYREG_PRT2_OE_SEL1
.set MOSI__PRTDSI__OUT_SEL0, CYREG_PRT2_OUT_SEL0
.set MOSI__PRTDSI__OUT_SEL1, CYREG_PRT2_OUT_SEL1
.set MOSI__PRTDSI__SYNC_OUT, CYREG_PRT2_SYNC_OUT
.set MOSI__PS, CYREG_PRT2_PS
.set MOSI__SHIFT, 6
.set MOSI__SLW, CYREG_PRT2_SLW

/* Rx_1 */
.set Rx_1__0__INTTYPE, CYREG_PICU1_INTTYPE6
.set Rx_1__0__MASK, 0x40
.set Rx_1__0__PC, CYREG_PRT1_PC6
.set Rx_1__0__PORT, 1
.set Rx_1__0__SHIFT, 6
.set Rx_1__AG, CYREG_PRT1_AG
.set Rx_1__AMUX, CYREG_PRT1_AMUX
.set Rx_1__BIE, CYREG_PRT1_BIE
.set Rx_1__BIT_MASK, CYREG_PRT1_BIT_MASK
.set Rx_1__BYP, CYREG_PRT1_BYP
.set Rx_1__CTL, CYREG_PRT1_CTL
.set Rx_1__DM0, CYREG_PRT1_DM0
.set Rx_1__DM1, CYREG_PRT1_DM1
.set Rx_1__DM2, CYREG_PRT1_DM2
.set Rx_1__DR, CYREG_PRT1_DR
.set Rx_1__INP_DIS, CYREG_PRT1_INP_DIS
.set Rx_1__INTTYPE_BASE, CYDEV_PICU_INTTYPE_PICU1_BASE
.set Rx_1__LCD_COM_SEG, CYREG_PRT1_LCD_COM_SEG
.set Rx_1__LCD_EN, CYREG_PRT1_LCD_EN
.set Rx_1__MASK, 0x40
.set Rx_1__PORT, 1
.set Rx_1__PRT, CYREG_PRT1_PRT
.set Rx_1__PRTDSI__CAPS_SEL, CYREG_PRT1_CAPS_SEL
.set Rx_1__PRTDSI__DBL_SYNC_IN, CYREG_PRT1_DBL_SYNC_IN
.set Rx_1__PRTDSI__OE_SEL0, CYREG_PRT1_OE_SEL0
.set Rx_1__PRTDSI__OE_SEL1, CYREG_PRT1_OE_SEL1
.set Rx_1__PRTDSI__OUT_SEL0, CYREG_PRT1_OUT_SEL0
.set Rx_1__PRTDSI__OUT_SEL1, CYREG_PRT1_OUT_SEL1
.set Rx_1__PRTDSI__SYNC_OUT, CYREG_PRT1_SYNC_OUT
.set Rx_1__PS, CYREG_PRT1_PS
.set Rx_1__SHIFT, 6
.set Rx_1__SLW, CYREG_PRT1_SLW

/* SCLK */
.set SCLK__0__INTTYPE, CYREG_PICU2_INTTYPE3
.set SCLK__0__MASK, 0x08
.set SCLK__0__PC, CYREG_PRT2_PC3
.set SCLK__0__PORT, 2
.set SCLK__0__SHIFT, 3
.set SCLK__AG, CYREG_PRT2_AG
.set SCLK__AMUX, CYREG_PRT2_AMUX
.set SCLK__BIE, CYREG_PRT2_BIE
.set SCLK__BIT_MASK, CYREG_PRT2_BIT_MASK
.set SCLK__BYP, CYREG_PRT2_BYP
.set SCLK__CTL, CYREG_PRT2_CTL
.set SCLK__DM0, CYREG_PRT2_DM0
.set SCLK__DM1, CYREG_PRT2_DM1
.set SCLK__DM2, CYREG_PRT2_DM2
.set SCLK__DR, CYREG_PRT2_DR
.set SCLK__INP_DIS, CYREG_PRT2_INP_DIS
.set SCLK__INTTYPE_BASE, CYDEV_PICU_INTTYPE_PICU2_BASE
.set SCLK__LCD_COM_SEG, CYREG_PRT2_LCD_COM_SEG
.set SCLK__LCD_EN, CYREG_PRT2_LCD_EN
.set SCLK__MASK, 0x08
.set SCLK__PORT, 2
.set SCLK__PRT, CYREG_PRT2_PRT
.set SCLK__PRTDSI__CAPS_SEL, CYREG_PRT2_CAPS_SEL
.set SCLK__PRTDSI__DBL_SYNC_IN, CYREG_PRT2_DBL_SYNC_IN
.set SCLK__PRTDSI__OE_SEL0, CYREG_PRT2_OE_SEL0
.set SCLK__PRTDSI__OE_SEL1, CYREG_PRT2_OE_SEL1
.set SCLK__PRTDSI__OUT_SEL0, CYREG_PRT2_OUT_SEL0
.set SCLK__PRTDSI__OUT_SEL1, CYREG_PRT2_OUT_SEL1
.set SCLK__PRTDSI__SYNC_OUT, CYREG_PRT2_SYNC_OUT
.set SCLK__PS, CYREG_PRT2_PS
.set SCLK__SHIFT, 3
.set SCLK__SLW, CYREG_PRT2_SLW

/* Tx_1 */
.set Tx_1__0__INTTYPE, CYREG_PICU1_INTTYPE4
.set Tx_1__0__MASK, 0x10
.set Tx_1__0__PC, CYREG_PRT1_PC4
.set Tx_1__0__PORT, 1
.set Tx_1__0__SHIFT, 4
.set Tx_1__AG, CYREG_PRT1_AG
.set Tx_1__AMUX, CYREG_PRT1_AMUX
.set Tx_1__BIE, CYREG_PRT1_BIE
.set Tx_1__BIT_MASK, CYREG_PRT1_BIT_MASK
.set Tx_1__BYP, CYREG_PRT1_BYP
.set Tx_1__CTL, CYREG_PRT1_CTL
.set Tx_1__DM0, CYREG_PRT1_DM0
.set Tx_1__DM1, CYREG_PRT1_DM1
.set Tx_1__DM2, CYREG_PRT1_DM2
.set Tx_1__DR, CYREG_PRT1_DR
.set Tx_1__INP_DIS, CYREG_PRT1_INP_DIS
.set Tx_1__INTTYPE_BASE, CYDEV_PICU_INTTYPE_PICU1_BASE
.set Tx_1__LCD_COM_SEG, CYREG_PRT1_LCD_COM_SEG
.set Tx_1__LCD_EN, CYREG_PRT1_LCD_EN
.set Tx_1__MASK, 0x10
.set Tx_1__PORT, 1
.set Tx_1__PRT, CYREG_PRT1_PRT
.set Tx_1__PRTDSI__CAPS_SEL, CYREG_PRT1_CAPS_SEL
.set Tx_1__PRTDSI__DBL_SYNC_IN, CYREG_PRT1_DBL_SYNC_IN
.set Tx_1__PRTDSI__OE_SEL0, CYREG_PRT1_OE_SEL0
.set Tx_1__PRTDSI__OE_SEL1, CYREG_PRT1_OE_SEL1
.set Tx_1__PRTDSI__OUT_SEL0, CYREG_PRT1_OUT_SEL0
.set Tx_1__PRTDSI__OUT_SEL1, CYREG_PRT1_OUT_SEL1
.set Tx_1__PRTDSI__SYNC_OUT, CYREG_PRT1_SYNC_OUT
.set Tx_1__PS, CYREG_PRT1_PS
.set Tx_1__SHIFT, 4
.set Tx_1__SLW, CYREG_PRT1_SLW

/* Pin_1 */
.set Pin_1__0__INTTYPE, CYREG_PICU2_INTTYPE1
.set Pin_1__0__MASK, 0x02
.set Pin_1__0__PC, CYREG_PRT2_PC1
.set Pin_1__0__PORT, 2
.set Pin_1__0__SHIFT, 1
.set Pin_1__AG, CYREG_PRT2_AG
.set Pin_1__AMUX, CYREG_PRT2_AMUX
.set Pin_1__BIE, CYREG_PRT2_BIE
.set Pin_1__BIT_MASK, CYREG_PRT2_BIT_MASK
.set Pin_1__BYP, CYREG_PRT2_BYP
.set Pin_1__CTL, CYREG_PRT2_CTL
.set Pin_1__DM0, CYREG_PRT2_DM0
.set Pin_1__DM1, CYREG_PRT2_DM1
.set Pin_1__DM2, CYREG_PRT2_DM2
.set Pin_1__DR, CYREG_PRT2_DR
.set Pin_1__INP_DIS, CYREG_PRT2_INP_DIS
.set Pin_1__INTTYPE_BASE, CYDEV_PICU_INTTYPE_PICU2_BASE
.set Pin_1__LCD_COM_SEG, CYREG_PRT2_LCD_COM_SEG
.set Pin_1__LCD_EN, CYREG_PRT2_LCD_EN
.set Pin_1__MASK, 0x02
.set Pin_1__PORT, 2
.set Pin_1__PRT, CYREG_PRT2_PRT
.set Pin_1__PRTDSI__CAPS_SEL, CYREG_PRT2_CAPS_SEL
.set Pin_1__PRTDSI__DBL_SYNC_IN, CYREG_PRT2_DBL_SYNC_IN
.set Pin_1__PRTDSI__OE_SEL0, CYREG_PRT2_OE_SEL0
.set Pin_1__PRTDSI__OE_SEL1, CYREG_PRT2_OE_SEL1
.set Pin_1__PRTDSI__OUT_SEL0, CYREG_PRT2_OUT_SEL0
.set Pin_1__PRTDSI__OUT_SEL1, CYREG_PRT2_OUT_SEL1
.set Pin_1__PRTDSI__SYNC_OUT, CYREG_PRT2_SYNC_OUT
.set Pin_1__PS, CYREG_PRT2_PS
.set Pin_1__SHIFT, 1
.set Pin_1__SLW, CYREG_PRT2_SLW

/* SPIM_1_BSPIM */
.set SPIM_1_BSPIM_BitCounter__16BIT_CONTROL_AUX_CTL_REG, CYREG_B1_UDB10_11_ACTL
.set SPIM_1_BSPIM_BitCounter__16BIT_CONTROL_CONTROL_REG, CYREG_B1_UDB10_11_CTL
.set SPIM_1_BSPIM_BitCounter__16BIT_CONTROL_COUNT_REG, CYREG_B1_UDB10_11_CTL
.set SPIM_1_BSPIM_BitCounter__16BIT_COUNT_CONTROL_REG, CYREG_B1_UDB10_11_CTL
.set SPIM_1_BSPIM_BitCounter__16BIT_COUNT_COUNT_REG, CYREG_B1_UDB10_11_CTL
.set SPIM_1_BSPIM_BitCounter__16BIT_MASK_MASK_REG, CYREG_B1_UDB10_11_MSK
.set SPIM_1_BSPIM_BitCounter__16BIT_MASK_PERIOD_REG, CYREG_B1_UDB10_11_MSK
.set SPIM_1_BSPIM_BitCounter__16BIT_PERIOD_MASK_REG, CYREG_B1_UDB10_11_MSK
.set SPIM_1_BSPIM_BitCounter__16BIT_PERIOD_PERIOD_REG, CYREG_B1_UDB10_11_MSK
.set SPIM_1_BSPIM_BitCounter__CONTROL_AUX_CTL_REG, CYREG_B1_UDB10_ACTL
.set SPIM_1_BSPIM_BitCounter__CONTROL_REG, CYREG_B1_UDB10_CTL
.set SPIM_1_BSPIM_BitCounter__CONTROL_ST_REG, CYREG_B1_UDB10_ST_CTL
.set SPIM_1_BSPIM_BitCounter__COUNT_REG, CYREG_B1_UDB10_CTL
.set SPIM_1_BSPIM_BitCounter__COUNT_ST_REG, CYREG_B1_UDB10_ST_CTL
.set SPIM_1_BSPIM_BitCounter__MASK_CTL_AUX_CTL_REG, CYREG_B1_UDB10_MSK_ACTL
.set SPIM_1_BSPIM_BitCounter__PER_CTL_AUX_CTL_REG, CYREG_B1_UDB10_MSK_ACTL
.set SPIM_1_BSPIM_BitCounter__PERIOD_REG, CYREG_B1_UDB10_MSK
.set SPIM_1_BSPIM_BitCounter_ST__16BIT_STATUS_AUX_CTL_REG, CYREG_B1_UDB10_11_ACTL
.set SPIM_1_BSPIM_BitCounter_ST__16BIT_STATUS_REG, CYREG_B1_UDB10_11_ST
.set SPIM_1_BSPIM_BitCounter_ST__MASK_REG, CYREG_B1_UDB10_MSK
.set SPIM_1_BSPIM_BitCounter_ST__MASK_ST_AUX_CTL_REG, CYREG_B1_UDB10_MSK_ACTL
.set SPIM_1_BSPIM_BitCounter_ST__PER_ST_AUX_CTL_REG, CYREG_B1_UDB10_MSK_ACTL
.set SPIM_1_BSPIM_BitCounter_ST__STATUS_AUX_CTL_REG, CYREG_B1_UDB10_ACTL
.set SPIM_1_BSPIM_BitCounter_ST__STATUS_CNT_REG, CYREG_B1_UDB10_ST_CTL
.set SPIM_1_BSPIM_BitCounter_ST__STATUS_CONTROL_REG, CYREG_B1_UDB10_ST_CTL
.set SPIM_1_BSPIM_BitCounter_ST__STATUS_REG, CYREG_B1_UDB10_ST
.set SPIM_1_BSPIM_RxStsReg__16BIT_STATUS_AUX_CTL_REG, CYREG_B0_UDB09_10_ACTL
.set SPIM_1_BSPIM_RxStsReg__16BIT_STATUS_REG, CYREG_B0_UDB09_10_ST
.set SPIM_1_BSPIM_RxStsReg__4__MASK, 0x10
.set SPIM_1_BSPIM_RxStsReg__4__POS, 4
.set SPIM_1_BSPIM_RxStsReg__5__MASK, 0x20
.set SPIM_1_BSPIM_RxStsReg__5__POS, 5
.set SPIM_1_BSPIM_RxStsReg__6__MASK, 0x40
.set SPIM_1_BSPIM_RxStsReg__6__POS, 6
.set SPIM_1_BSPIM_RxStsReg__MASK, 0x70
.set SPIM_1_BSPIM_RxStsReg__MASK_REG, CYREG_B0_UDB09_MSK
.set SPIM_1_BSPIM_RxStsReg__STATUS_AUX_CTL_REG, CYREG_B0_UDB09_ACTL
.set SPIM_1_BSPIM_RxStsReg__STATUS_REG, CYREG_B0_UDB09_ST
.set SPIM_1_BSPIM_sR8_Dp_u0__16BIT_A0_REG, CYREG_B1_UDB10_11_A0
.set SPIM_1_BSPIM_sR8_Dp_u0__16BIT_A1_REG, CYREG_B1_UDB10_11_A1
.set SPIM_1_BSPIM_sR8_Dp_u0__16BIT_D0_REG, CYREG_B1_UDB10_11_D0
.set SPIM_1_BSPIM_sR8_Dp_u0__16BIT_D1_REG, CYREG_B1_UDB10_11_D1
.set SPIM_1_BSPIM_sR8_Dp_u0__16BIT_DP_AUX_CTL_REG, CYREG_B1_UDB10_11_ACTL
.set SPIM_1_BSPIM_sR8_Dp_u0__16BIT_F0_REG, CYREG_B1_UDB10_11_F0
.set SPIM_1_BSPIM_sR8_Dp_u0__16BIT_F1_REG, CYREG_B1_UDB10_11_F1
.set SPIM_1_BSPIM_sR8_Dp_u0__A0_A1_REG, CYREG_B1_UDB10_A0_A1
.set SPIM_1_BSPIM_sR8_Dp_u0__A0_REG, CYREG_B1_UDB10_A0
.set SPIM_1_BSPIM_sR8_Dp_u0__A1_REG, CYREG_B1_UDB10_A1
.set SPIM_1_BSPIM_sR8_Dp_u0__D0_D1_REG, CYREG_B1_UDB10_D0_D1
.set SPIM_1_BSPIM_sR8_Dp_u0__D0_REG, CYREG_B1_UDB10_D0
.set SPIM_1_BSPIM_sR8_Dp_u0__D1_REG, CYREG_B1_UDB10_D1
.set SPIM_1_BSPIM_sR8_Dp_u0__DP_AUX_CTL_REG, CYREG_B1_UDB10_ACTL
.set SPIM_1_BSPIM_sR8_Dp_u0__F0_F1_REG, CYREG_B1_UDB10_F0_F1
.set SPIM_1_BSPIM_sR8_Dp_u0__F0_REG, CYREG_B1_UDB10_F0
.set SPIM_1_BSPIM_sR8_Dp_u0__F1_REG, CYREG_B1_UDB10_F1
.set SPIM_1_BSPIM_sR8_Dp_u0__MSK_DP_AUX_CTL_REG, CYREG_B1_UDB10_MSK_ACTL
.set SPIM_1_BSPIM_sR8_Dp_u0__PER_DP_AUX_CTL_REG, CYREG_B1_UDB10_MSK_ACTL
.set SPIM_1_BSPIM_TxStsReg__0__MASK, 0x01
.set SPIM_1_BSPIM_TxStsReg__0__POS, 0
.set SPIM_1_BSPIM_TxStsReg__1__MASK, 0x02
.set SPIM_1_BSPIM_TxStsReg__1__POS, 1
.set SPIM_1_BSPIM_TxStsReg__16BIT_STATUS_AUX_CTL_REG, CYREG_B1_UDB09_10_ACTL
.set SPIM_1_BSPIM_TxStsReg__16BIT_STATUS_REG, CYREG_B1_UDB09_10_ST
.set SPIM_1_BSPIM_TxStsReg__2__MASK, 0x04
.set SPIM_1_BSPIM_TxStsReg__2__POS, 2
.set SPIM_1_BSPIM_TxStsReg__3__MASK, 0x08
.set SPIM_1_BSPIM_TxStsReg__3__POS, 3
.set SPIM_1_BSPIM_TxStsReg__4__MASK, 0x10
.set SPIM_1_BSPIM_TxStsReg__4__POS, 4
.set SPIM_1_BSPIM_TxStsReg__MASK, 0x1F
.set SPIM_1_BSPIM_TxStsReg__MASK_REG, CYREG_B1_UDB09_MSK
.set SPIM_1_BSPIM_TxStsReg__STATUS_AUX_CTL_REG, CYREG_B1_UDB09_ACTL
.set SPIM_1_BSPIM_TxStsReg__STATUS_REG, CYREG_B1_UDB09_ST

/* SPIM_1_IntClock */
.set SPIM_1_IntClock__CFG0, CYREG_CLKDIST_DCFG1_CFG0
.set SPIM_1_IntClock__CFG1, CYREG_CLKDIST_DCFG1_CFG1
.set SPIM_1_IntClock__CFG2, CYREG_CLKDIST_DCFG1_CFG2
.set SPIM_1_IntClock__CFG2_SRC_SEL_MASK, 0x07
.set SPIM_1_IntClock__INDEX, 0x01
.set SPIM_1_IntClock__PM_ACT_CFG, CYREG_PM_ACT_CFG2
.set SPIM_1_IntClock__PM_ACT_MSK, 0x02
.set SPIM_1_IntClock__PM_STBY_CFG, CYREG_PM_STBY_CFG2
.set SPIM_1_IntClock__PM_STBY_MSK, 0x02

/* UART_1_BUART */
.set UART_1_BUART_sRX_RxBitCounter__16BIT_CONTROL_AUX_CTL_REG, CYREG_B0_UDB08_09_ACTL
.set UART_1_BUART_sRX_RxBitCounter__16BIT_CONTROL_CONTROL_REG, CYREG_B0_UDB08_09_CTL
.set UART_1_BUART_sRX_RxBitCounter__16BIT_CONTROL_COUNT_REG, CYREG_B0_UDB08_09_CTL
.set UART_1_BUART_sRX_RxBitCounter__16BIT_COUNT_CONTROL_REG, CYREG_B0_UDB08_09_CTL
.set UART_1_BUART_sRX_RxBitCounter__16BIT_COUNT_COUNT_REG, CYREG_B0_UDB08_09_CTL
.set UART_1_BUART_sRX_RxBitCounter__16BIT_MASK_MASK_REG, CYREG_B0_UDB08_09_MSK
.set UART_1_BUART_sRX_RxBitCounter__16BIT_MASK_PERIOD_REG, CYREG_B0_UDB08_09_MSK
.set UART_1_BUART_sRX_RxBitCounter__16BIT_PERIOD_MASK_REG, CYREG_B0_UDB08_09_MSK
.set UART_1_BUART_sRX_RxBitCounter__16BIT_PERIOD_PERIOD_REG, CYREG_B0_UDB08_09_MSK
.set UART_1_BUART_sRX_RxBitCounter__CONTROL_AUX_CTL_REG, CYREG_B0_UDB08_ACTL
.set UART_1_BUART_sRX_RxBitCounter__CONTROL_REG, CYREG_B0_UDB08_CTL
.set UART_1_BUART_sRX_RxBitCounter__CONTROL_ST_REG, CYREG_B0_UDB08_ST_CTL
.set UART_1_BUART_sRX_RxBitCounter__COUNT_REG, CYREG_B0_UDB08_CTL
.set UART_1_BUART_sRX_RxBitCounter__COUNT_ST_REG, CYREG_B0_UDB08_ST_CTL
.set UART_1_BUART_sRX_RxBitCounter__MASK_CTL_AUX_CTL_REG, CYREG_B0_UDB08_MSK_ACTL
.set UART_1_BUART_sRX_RxBitCounter__PER_CTL_AUX_CTL_REG, CYREG_B0_UDB08_MSK_ACTL
.set UART_1_BUART_sRX_RxBitCounter__PERIOD_REG, CYREG_B0_UDB08_MSK
.set UART_1_BUART_sRX_RxBitCounter_ST__16BIT_STATUS_AUX_CTL_REG, CYREG_B0_UDB08_09_ACTL
.set UART_1_BUART_sRX_RxBitCounter_ST__16BIT_STATUS_REG, CYREG_B0_UDB08_09_ST
.set UART_1_BUART_sRX_RxBitCounter_ST__MASK_REG, CYREG_B0_UDB08_MSK
.set UART_1_BUART_sRX_RxBitCounter_ST__MASK_ST_AUX_CTL_REG, CYREG_B0_UDB08_MSK_ACTL
.set UART_1_BUART_sRX_RxBitCounter_ST__PER_ST_AUX_CTL_REG, CYREG_B0_UDB08_MSK_ACTL
.set UART_1_BUART_sRX_RxBitCounter_ST__STATUS_AUX_CTL_REG, CYREG_B0_UDB08_ACTL
.set UART_1_BUART_sRX_RxBitCounter_ST__STATUS_CNT_REG, CYREG_B0_UDB08_ST_CTL
.set UART_1_BUART_sRX_RxBitCounter_ST__STATUS_CONTROL_REG, CYREG_B0_UDB08_ST_CTL
.set UART_1_BUART_sRX_RxBitCounter_ST__STATUS_REG, CYREG_B0_UDB08_ST
.set UART_1_BUART_sRX_RxShifter_u0__16BIT_A0_REG, CYREG_B0_UDB11_12_A0
.set UART_1_BUART_sRX_RxShifter_u0__16BIT_A1_REG, CYREG_B0_UDB11_12_A1
.set UART_1_BUART_sRX_RxShifter_u0__16BIT_D0_REG, CYREG_B0_UDB11_12_D0
.set UART_1_BUART_sRX_RxShifter_u0__16BIT_D1_REG, CYREG_B0_UDB11_12_D1
.set UART_1_BUART_sRX_RxShifter_u0__16BIT_DP_AUX_CTL_REG, CYREG_B0_UDB11_12_ACTL
.set UART_1_BUART_sRX_RxShifter_u0__16BIT_F0_REG, CYREG_B0_UDB11_12_F0
.set UART_1_BUART_sRX_RxShifter_u0__16BIT_F1_REG, CYREG_B0_UDB11_12_F1
.set UART_1_BUART_sRX_RxShifter_u0__A0_A1_REG, CYREG_B0_UDB11_A0_A1
.set UART_1_BUART_sRX_RxShifter_u0__A0_REG, CYREG_B0_UDB11_A0
.set UART_1_BUART_sRX_RxShifter_u0__A1_REG, CYREG_B0_UDB11_A1
.set UART_1_BUART_sRX_RxShifter_u0__D0_D1_REG, CYREG_B0_UDB11_D0_D1
.set UART_1_BUART_sRX_RxShifter_u0__D0_REG, CYREG_B0_UDB11_D0
.set UART_1_BUART_sRX_RxShifter_u0__D1_REG, CYREG_B0_UDB11_D1
.set UART_1_BUART_sRX_RxShifter_u0__DP_AUX_CTL_REG, CYREG_B0_UDB11_ACTL
.set UART_1_BUART_sRX_RxShifter_u0__F0_F1_REG, CYREG_B0_UDB11_F0_F1
.set UART_1_BUART_sRX_RxShifter_u0__F0_REG, CYREG_B0_UDB11_F0
.set UART_1_BUART_sRX_RxShifter_u0__F1_REG, CYREG_B0_UDB11_F1
.set UART_1_BUART_sRX_RxSts__16BIT_STATUS_AUX_CTL_REG, CYREG_B0_UDB10_11_ACTL
.set UART_1_BUART_sRX_RxSts__16BIT_STATUS_REG, CYREG_B0_UDB10_11_ST
.set UART_1_BUART_sRX_RxSts__3__MASK, 0x08
.set UART_1_BUART_sRX_RxSts__3__POS, 3
.set UART_1_BUART_sRX_RxSts__4__MASK, 0x10
.set UART_1_BUART_sRX_RxSts__4__POS, 4
.set UART_1_BUART_sRX_RxSts__5__MASK, 0x20
.set UART_1_BUART_sRX_RxSts__5__POS, 5
.set UART_1_BUART_sRX_RxSts__MASK, 0x38
.set UART_1_BUART_sRX_RxSts__MASK_REG, CYREG_B0_UDB10_MSK
.set UART_1_BUART_sRX_RxSts__STATUS_AUX_CTL_REG, CYREG_B0_UDB10_ACTL
.set UART_1_BUART_sRX_RxSts__STATUS_REG, CYREG_B0_UDB10_ST
.set UART_1_BUART_sTX_sCLOCK_TxBitClkGen__16BIT_A0_REG, CYREG_B0_UDB10_11_A0
.set UART_1_BUART_sTX_sCLOCK_TxBitClkGen__16BIT_A1_REG, CYREG_B0_UDB10_11_A1
.set UART_1_BUART_sTX_sCLOCK_TxBitClkGen__16BIT_D0_REG, CYREG_B0_UDB10_11_D0
.set UART_1_BUART_sTX_sCLOCK_TxBitClkGen__16BIT_D1_REG, CYREG_B0_UDB10_11_D1
.set UART_1_BUART_sTX_sCLOCK_TxBitClkGen__16BIT_DP_AUX_CTL_REG, CYREG_B0_UDB10_11_ACTL
.set UART_1_BUART_sTX_sCLOCK_TxBitClkGen__16BIT_F0_REG, CYREG_B0_UDB10_11_F0
.set UART_1_BUART_sTX_sCLOCK_TxBitClkGen__16BIT_F1_REG, CYREG_B0_UDB10_11_F1
.set UART_1_BUART_sTX_sCLOCK_TxBitClkGen__A0_A1_REG, CYREG_B0_UDB10_A0_A1
.set UART_1_BUART_sTX_sCLOCK_TxBitClkGen__A0_REG, CYREG_B0_UDB10_A0
.set UART_1_BUART_sTX_sCLOCK_TxBitClkGen__A1_REG, CYREG_B0_UDB10_A1
.set UART_1_BUART_sTX_sCLOCK_TxBitClkGen__D0_D1_REG, CYREG_B0_UDB10_D0_D1
.set UART_1_BUART_sTX_sCLOCK_TxBitClkGen__D0_REG, CYREG_B0_UDB10_D0
.set UART_1_BUART_sTX_sCLOCK_TxBitClkGen__D1_REG, CYREG_B0_UDB10_D1
.set UART_1_BUART_sTX_sCLOCK_TxBitClkGen__DP_AUX_CTL_REG, CYREG_B0_UDB10_ACTL
.set UART_1_BUART_sTX_sCLOCK_TxBitClkGen__F0_F1_REG, CYREG_B0_UDB10_F0_F1
.set UART_1_BUART_sTX_sCLOCK_TxBitClkGen__F0_REG, CYREG_B0_UDB10_F0
.set UART_1_BUART_sTX_sCLOCK_TxBitClkGen__F1_REG, CYREG_B0_UDB10_F1
.set UART_1_BUART_sTX_TxShifter_u0__16BIT_A0_REG, CYREG_B1_UDB08_09_A0
.set UART_1_BUART_sTX_TxShifter_u0__16BIT_A1_REG, CYREG_B1_UDB08_09_A1
.set UART_1_BUART_sTX_TxShifter_u0__16BIT_D0_REG, CYREG_B1_UDB08_09_D0
.set UART_1_BUART_sTX_TxShifter_u0__16BIT_D1_REG, CYREG_B1_UDB08_09_D1
.set UART_1_BUART_sTX_TxShifter_u0__16BIT_DP_AUX_CTL_REG, CYREG_B1_UDB08_09_ACTL
.set UART_1_BUART_sTX_TxShifter_u0__16BIT_F0_REG, CYREG_B1_UDB08_09_F0
.set UART_1_BUART_sTX_TxShifter_u0__16BIT_F1_REG, CYREG_B1_UDB08_09_F1
.set UART_1_BUART_sTX_TxShifter_u0__A0_A1_REG, CYREG_B1_UDB08_A0_A1
.set UART_1_BUART_sTX_TxShifter_u0__A0_REG, CYREG_B1_UDB08_A0
.set UART_1_BUART_sTX_TxShifter_u0__A1_REG, CYREG_B1_UDB08_A1
.set UART_1_BUART_sTX_TxShifter_u0__D0_D1_REG, CYREG_B1_UDB08_D0_D1
.set UART_1_BUART_sTX_TxShifter_u0__D0_REG, CYREG_B1_UDB08_D0
.set UART_1_BUART_sTX_TxShifter_u0__D1_REG, CYREG_B1_UDB08_D1
.set UART_1_BUART_sTX_TxShifter_u0__DP_AUX_CTL_REG, CYREG_B1_UDB08_ACTL
.set UART_1_BUART_sTX_TxShifter_u0__F0_F1_REG, CYREG_B1_UDB08_F0_F1
.set UART_1_BUART_sTX_TxShifter_u0__F0_REG, CYREG_B1_UDB08_F0
.set UART_1_BUART_sTX_TxShifter_u0__F1_REG, CYREG_B1_UDB08_F1
.set UART_1_BUART_sTX_TxSts__0__MASK, 0x01
.set UART_1_BUART_sTX_TxSts__0__POS, 0
.set UART_1_BUART_sTX_TxSts__1__MASK, 0x02
.set UART_1_BUART_sTX_TxSts__1__POS, 1
.set UART_1_BUART_sTX_TxSts__16BIT_STATUS_AUX_CTL_REG, CYREG_B0_UDB11_12_ACTL
.set UART_1_BUART_sTX_TxSts__16BIT_STATUS_REG, CYREG_B0_UDB11_12_ST
.set UART_1_BUART_sTX_TxSts__2__MASK, 0x04
.set UART_1_BUART_sTX_TxSts__2__POS, 2
.set UART_1_BUART_sTX_TxSts__3__MASK, 0x08
.set UART_1_BUART_sTX_TxSts__3__POS, 3
.set UART_1_BUART_sTX_TxSts__MASK, 0x0F
.set UART_1_BUART_sTX_TxSts__MASK_REG, CYREG_B0_UDB11_MSK
.set UART_1_BUART_sTX_TxSts__STATUS_AUX_CTL_REG, CYREG_B0_UDB11_ACTL
.set UART_1_BUART_sTX_TxSts__STATUS_REG, CYREG_B0_UDB11_ST

/* UART_1_IntClock */
.set UART_1_IntClock__CFG0, CYREG_CLKDIST_DCFG2_CFG0
.set UART_1_IntClock__CFG1, CYREG_CLKDIST_DCFG2_CFG1
.set UART_1_IntClock__CFG2, CYREG_CLKDIST_DCFG2_CFG2
.set UART_1_IntClock__CFG2_SRC_SEL_MASK, 0x07
.set UART_1_IntClock__INDEX, 0x02
.set UART_1_IntClock__PM_ACT_CFG, CYREG_PM_ACT_CFG2
.set UART_1_IntClock__PM_ACT_MSK, 0x04
.set UART_1_IntClock__PM_STBY_CFG, CYREG_PM_STBY_CFG2
.set UART_1_IntClock__PM_STBY_MSK, 0x04

/* VDAC8_1_viDAC8 */
.set VDAC8_1_viDAC8__CR0, CYREG_DAC0_CR0
.set VDAC8_1_viDAC8__CR1, CYREG_DAC0_CR1
.set VDAC8_1_viDAC8__D, CYREG_DAC0_D
.set VDAC8_1_viDAC8__PM_ACT_CFG, CYREG_PM_ACT_CFG8
.set VDAC8_1_viDAC8__PM_ACT_MSK, 0x01
.set VDAC8_1_viDAC8__PM_STBY_CFG, CYREG_PM_STBY_CFG8
.set VDAC8_1_viDAC8__PM_STBY_MSK, 0x01
.set VDAC8_1_viDAC8__STROBE, CYREG_DAC0_STROBE
.set VDAC8_1_viDAC8__SW0, CYREG_DAC0_SW0
.set VDAC8_1_viDAC8__SW2, CYREG_DAC0_SW2
.set VDAC8_1_viDAC8__SW3, CYREG_DAC0_SW3
.set VDAC8_1_viDAC8__SW4, CYREG_DAC0_SW4
.set VDAC8_1_viDAC8__TR, CYREG_DAC0_TR
.set VDAC8_1_viDAC8__TRIM__M1, CYREG_FLSHID_CUST_TABLES_DAC0_M1
.set VDAC8_1_viDAC8__TRIM__M2, CYREG_FLSHID_CUST_TABLES_DAC0_M2
.set VDAC8_1_viDAC8__TRIM__M3, CYREG_FLSHID_CUST_TABLES_DAC0_M3
.set VDAC8_1_viDAC8__TRIM__M4, CYREG_FLSHID_CUST_TABLES_DAC0_M4
.set VDAC8_1_viDAC8__TRIM__M5, CYREG_FLSHID_CUST_TABLES_DAC0_M5
.set VDAC8_1_viDAC8__TRIM__M6, CYREG_FLSHID_CUST_TABLES_DAC0_M6
.set VDAC8_1_viDAC8__TRIM__M7, CYREG_FLSHID_CUST_TABLES_DAC0_M7
.set VDAC8_1_viDAC8__TRIM__M8, CYREG_FLSHID_CUST_TABLES_DAC0_M8
.set VDAC8_1_viDAC8__TST, CYREG_DAC0_TST

/* ADC_Input */
.set ADC_Input__0__INTTYPE, CYREG_PICU0_INTTYPE7
.set ADC_Input__0__MASK, 0x80
.set ADC_Input__0__PC, CYREG_PRT0_PC7
.set ADC_Input__0__PORT, 0
.set ADC_Input__0__SHIFT, 7
.set ADC_Input__AG, CYREG_PRT0_AG
.set ADC_Input__AMUX, CYREG_PRT0_AMUX
.set ADC_Input__BIE, CYREG_PRT0_BIE
.set ADC_Input__BIT_MASK, CYREG_PRT0_BIT_MASK
.set ADC_Input__BYP, CYREG_PRT0_BYP
.set ADC_Input__CTL, CYREG_PRT0_CTL
.set ADC_Input__DM0, CYREG_PRT0_DM0
.set ADC_Input__DM1, CYREG_PRT0_DM1
.set ADC_Input__DM2, CYREG_PRT0_DM2
.set ADC_Input__DR, CYREG_PRT0_DR
.set ADC_Input__INP_DIS, CYREG_PRT0_INP_DIS
.set ADC_Input__INTTYPE_BASE, CYDEV_PICU_INTTYPE_PICU0_BASE
.set ADC_Input__LCD_COM_SEG, CYREG_PRT0_LCD_COM_SEG
.set ADC_Input__LCD_EN, CYREG_PRT0_LCD_EN
.set ADC_Input__MASK, 0x80
.set ADC_Input__PORT, 0
.set ADC_Input__PRT, CYREG_PRT0_PRT
.set ADC_Input__PRTDSI__CAPS_SEL, CYREG_PRT0_CAPS_SEL
.set ADC_Input__PRTDSI__DBL_SYNC_IN, CYREG_PRT0_DBL_SYNC_IN
.set ADC_Input__PRTDSI__OE_SEL0, CYREG_PRT0_OE_SEL0
.set ADC_Input__PRTDSI__OE_SEL1, CYREG_PRT0_OE_SEL1
.set ADC_Input__PRTDSI__OUT_SEL0, CYREG_PRT0_OUT_SEL0
.set ADC_Input__PRTDSI__OUT_SEL1, CYREG_PRT0_OUT_SEL1
.set ADC_Input__PRTDSI__SYNC_OUT, CYREG_PRT0_SYNC_OUT
.set ADC_Input__PS, CYREG_PRT0_PS
.set ADC_Input__SHIFT, 7
.set ADC_Input__SLW, CYREG_PRT0_SLW

/* DAC_Output */
.set DAC_Output__0__INTTYPE, CYREG_PICU0_INTTYPE6
.set DAC_Output__0__MASK, 0x40
.set DAC_Output__0__PC, CYREG_PRT0_PC6
.set DAC_Output__0__PORT, 0
.set DAC_Output__0__SHIFT, 6
.set DAC_Output__AG, CYREG_PRT0_AG
.set DAC_Output__AMUX, CYREG_PRT0_AMUX
.set DAC_Output__BIE, CYREG_PRT0_BIE
.set DAC_Output__BIT_MASK, CYREG_PRT0_BIT_MASK
.set DAC_Output__BYP, CYREG_PRT0_BYP
.set DAC_Output__CTL, CYREG_PRT0_CTL
.set DAC_Output__DM0, CYREG_PRT0_DM0
.set DAC_Output__DM1, CYREG_PRT0_DM1
.set DAC_Output__DM2, CYREG_PRT0_DM2
.set DAC_Output__DR, CYREG_PRT0_DR
.set DAC_Output__INP_DIS, CYREG_PRT0_INP_DIS
.set DAC_Output__INTTYPE_BASE, CYDEV_PICU_INTTYPE_PICU0_BASE
.set DAC_Output__LCD_COM_SEG, CYREG_PRT0_LCD_COM_SEG
.set DAC_Output__LCD_EN, CYREG_PRT0_LCD_EN
.set DAC_Output__MASK, 0x40
.set DAC_Output__PORT, 0
.set DAC_Output__PRT, CYREG_PRT0_PRT
.set DAC_Output__PRTDSI__CAPS_SEL, CYREG_PRT0_CAPS_SEL
.set DAC_Output__PRTDSI__DBL_SYNC_IN, CYREG_PRT0_DBL_SYNC_IN
.set DAC_Output__PRTDSI__OE_SEL0, CYREG_PRT0_OE_SEL0
.set DAC_Output__PRTDSI__OE_SEL1, CYREG_PRT0_OE_SEL1
.set DAC_Output__PRTDSI__OUT_SEL0, CYREG_PRT0_OUT_SEL0
.set DAC_Output__PRTDSI__OUT_SEL1, CYREG_PRT0_OUT_SEL1
.set DAC_Output__PRTDSI__SYNC_OUT, CYREG_PRT0_SYNC_OUT
.set DAC_Output__PS, CYREG_PRT0_PS
.set DAC_Output__SHIFT, 6
.set DAC_Output__SLW, CYREG_PRT0_SLW

/* ADC_DelSig_1_DEC */
.set ADC_DelSig_1_DEC__COHER, CYREG_DEC_COHER
.set ADC_DelSig_1_DEC__CR, CYREG_DEC_CR
.set ADC_DelSig_1_DEC__DR1, CYREG_DEC_DR1
.set ADC_DelSig_1_DEC__DR2, CYREG_DEC_DR2
.set ADC_DelSig_1_DEC__DR2H, CYREG_DEC_DR2H
.set ADC_DelSig_1_DEC__GCOR, CYREG_DEC_GCOR
.set ADC_DelSig_1_DEC__GCORH, CYREG_DEC_GCORH
.set ADC_DelSig_1_DEC__GVAL, CYREG_DEC_GVAL
.set ADC_DelSig_1_DEC__OCOR, CYREG_DEC_OCOR
.set ADC_DelSig_1_DEC__OCORH, CYREG_DEC_OCORH
.set ADC_DelSig_1_DEC__OCORM, CYREG_DEC_OCORM
.set ADC_DelSig_1_DEC__OUTSAMP, CYREG_DEC_OUTSAMP
.set ADC_DelSig_1_DEC__OUTSAMPH, CYREG_DEC_OUTSAMPH
.set ADC_DelSig_1_DEC__OUTSAMPM, CYREG_DEC_OUTSAMPM
.set ADC_DelSig_1_DEC__OUTSAMPS, CYREG_DEC_OUTSAMPS
.set ADC_DelSig_1_DEC__PM_ACT_CFG, CYREG_PM_ACT_CFG10
.set ADC_DelSig_1_DEC__PM_ACT_MSK, 0x01
.set ADC_DelSig_1_DEC__PM_STBY_CFG, CYREG_PM_STBY_CFG10
.set ADC_DelSig_1_DEC__PM_STBY_MSK, 0x01
.set ADC_DelSig_1_DEC__SHIFT1, CYREG_DEC_SHIFT1
.set ADC_DelSig_1_DEC__SHIFT2, CYREG_DEC_SHIFT2
.set ADC_DelSig_1_DEC__SR, CYREG_DEC_SR
.set ADC_DelSig_1_DEC__TRIM__M1, CYREG_FLSHID_CUST_TABLES_DEC_M1
.set ADC_DelSig_1_DEC__TRIM__M2, CYREG_FLSHID_CUST_TABLES_DEC_M2
.set ADC_DelSig_1_DEC__TRIM__M3, CYREG_FLSHID_CUST_TABLES_DEC_M3
.set ADC_DelSig_1_DEC__TRIM__M4, CYREG_FLSHID_CUST_TABLES_DEC_M4
.set ADC_DelSig_1_DEC__TRIM__M5, CYREG_FLSHID_CUST_TABLES_DEC_M5
.set ADC_DelSig_1_DEC__TRIM__M6, CYREG_FLSHID_CUST_TABLES_DEC_M6
.set ADC_DelSig_1_DEC__TRIM__M7, CYREG_FLSHID_CUST_TABLES_DEC_M7
.set ADC_DelSig_1_DEC__TRIM__M8, CYREG_FLSHID_CUST_TABLES_DEC_M8

/* ADC_DelSig_1_DSM */
.set ADC_DelSig_1_DSM__BUF0, CYREG_DSM0_BUF0
.set ADC_DelSig_1_DSM__BUF1, CYREG_DSM0_BUF1
.set ADC_DelSig_1_DSM__BUF2, CYREG_DSM0_BUF2
.set ADC_DelSig_1_DSM__BUF3, CYREG_DSM0_BUF3
.set ADC_DelSig_1_DSM__CLK, CYREG_DSM0_CLK
.set ADC_DelSig_1_DSM__CR0, CYREG_DSM0_CR0
.set ADC_DelSig_1_DSM__CR1, CYREG_DSM0_CR1
.set ADC_DelSig_1_DSM__CR10, CYREG_DSM0_CR10
.set ADC_DelSig_1_DSM__CR11, CYREG_DSM0_CR11
.set ADC_DelSig_1_DSM__CR12, CYREG_DSM0_CR12
.set ADC_DelSig_1_DSM__CR13, CYREG_DSM0_CR13
.set ADC_DelSig_1_DSM__CR14, CYREG_DSM0_CR14
.set ADC_DelSig_1_DSM__CR15, CYREG_DSM0_CR15
.set ADC_DelSig_1_DSM__CR16, CYREG_DSM0_CR16
.set ADC_DelSig_1_DSM__CR17, CYREG_DSM0_CR17
.set ADC_DelSig_1_DSM__CR2, CYREG_DSM0_CR2
.set ADC_DelSig_1_DSM__CR3, CYREG_DSM0_CR3
.set ADC_DelSig_1_DSM__CR4, CYREG_DSM0_CR4
.set ADC_DelSig_1_DSM__CR5, CYREG_DSM0_CR5
.set ADC_DelSig_1_DSM__CR6, CYREG_DSM0_CR6
.set ADC_DelSig_1_DSM__CR7, CYREG_DSM0_CR7
.set ADC_DelSig_1_DSM__CR8, CYREG_DSM0_CR8
.set ADC_DelSig_1_DSM__CR9, CYREG_DSM0_CR9
.set ADC_DelSig_1_DSM__DEM0, CYREG_DSM0_DEM0
.set ADC_DelSig_1_DSM__DEM1, CYREG_DSM0_DEM1
.set ADC_DelSig_1_DSM__MISC, CYREG_DSM0_MISC
.set ADC_DelSig_1_DSM__OUT0, CYREG_DSM0_OUT0
.set ADC_DelSig_1_DSM__OUT1, CYREG_DSM0_OUT1
.set ADC_DelSig_1_DSM__REF0, CYREG_DSM0_REF0
.set ADC_DelSig_1_DSM__REF1, CYREG_DSM0_REF1
.set ADC_DelSig_1_DSM__REF2, CYREG_DSM0_REF2
.set ADC_DelSig_1_DSM__REF3, CYREG_DSM0_REF3
.set ADC_DelSig_1_DSM__RSVD1, CYREG_DSM0_RSVD1
.set ADC_DelSig_1_DSM__SW0, CYREG_DSM0_SW0
.set ADC_DelSig_1_DSM__SW2, CYREG_DSM0_SW2
.set ADC_DelSig_1_DSM__SW3, CYREG_DSM0_SW3
.set ADC_DelSig_1_DSM__SW4, CYREG_DSM0_SW4
.set ADC_DelSig_1_DSM__SW6, CYREG_DSM0_SW6
.set ADC_DelSig_1_DSM__TR0, CYREG_NPUMP_DSM_TR0
.set ADC_DelSig_1_DSM__TST0, CYREG_DSM0_TST0
.set ADC_DelSig_1_DSM__TST1, CYREG_DSM0_TST1

/* ADC_DelSig_1_Ext_CP_Clk */
.set ADC_DelSig_1_Ext_CP_Clk__CFG0, CYREG_CLKDIST_DCFG0_CFG0
.set ADC_DelSig_1_Ext_CP_Clk__CFG1, CYREG_CLKDIST_DCFG0_CFG1
.set ADC_DelSig_1_Ext_CP_Clk__CFG2, CYREG_CLKDIST_DCFG0_CFG2
.set ADC_DelSig_1_Ext_CP_Clk__CFG2_SRC_SEL_MASK, 0x07
.set ADC_DelSig_1_Ext_CP_Clk__INDEX, 0x00
.set ADC_DelSig_1_Ext_CP_Clk__PM_ACT_CFG, CYREG_PM_ACT_CFG2
.set ADC_DelSig_1_Ext_CP_Clk__PM_ACT_MSK, 0x01
.set ADC_DelSig_1_Ext_CP_Clk__PM_STBY_CFG, CYREG_PM_STBY_CFG2
.set ADC_DelSig_1_Ext_CP_Clk__PM_STBY_MSK, 0x01

/* ADC_DelSig_1_IRQ */
.set ADC_DelSig_1_IRQ__INTC_CLR_EN_REG, CYREG_NVIC_CLRENA0
.set ADC_DelSig_1_IRQ__INTC_CLR_PD_REG, CYREG_NVIC_CLRPEND0
.set ADC_DelSig_1_IRQ__INTC_MASK, 0x20000000
.set ADC_DelSig_1_IRQ__INTC_NUMBER, 29
.set ADC_DelSig_1_IRQ__INTC_PRIOR_NUM, 7
.set ADC_DelSig_1_IRQ__INTC_PRIOR_REG, CYREG_NVIC_PRI_29
.set ADC_DelSig_1_IRQ__INTC_SET_EN_REG, CYREG_NVIC_SETENA0
.set ADC_DelSig_1_IRQ__INTC_SET_PD_REG, CYREG_NVIC_SETPEND0

/* ADC_DelSig_1_theACLK */
.set ADC_DelSig_1_theACLK__CFG0, CYREG_CLKDIST_ACFG0_CFG0
.set ADC_DelSig_1_theACLK__CFG1, CYREG_CLKDIST_ACFG0_CFG1
.set ADC_DelSig_1_theACLK__CFG2, CYREG_CLKDIST_ACFG0_CFG2
.set ADC_DelSig_1_theACLK__CFG2_SRC_SEL_MASK, 0x07
.set ADC_DelSig_1_theACLK__CFG3, CYREG_CLKDIST_ACFG0_CFG3
.set ADC_DelSig_1_theACLK__CFG3_PHASE_DLY_MASK, 0x0F
.set ADC_DelSig_1_theACLK__INDEX, 0x00
.set ADC_DelSig_1_theACLK__PM_ACT_CFG, CYREG_PM_ACT_CFG1
.set ADC_DelSig_1_theACLK__PM_ACT_MSK, 0x01
.set ADC_DelSig_1_theACLK__PM_STBY_CFG, CYREG_PM_STBY_CFG1
.set ADC_DelSig_1_theACLK__PM_STBY_MSK, 0x01

/* Miscellaneous */
.set BCLK__BUS_CLK__HZ, 24000000
.set BCLK__BUS_CLK__KHZ, 24000
.set BCLK__BUS_CLK__MHZ, 24
.set CYDEV_CHIP_DIE_LEOPARD, 1
.set CYDEV_CHIP_DIE_PANTHER, 18
.set CYDEV_CHIP_DIE_PSOC4A, 10
.set CYDEV_CHIP_DIE_PSOC5LP, 17
.set CYDEV_CHIP_DIE_TMA4, 2
.set CYDEV_CHIP_DIE_UNKNOWN, 0
.set CYDEV_CHIP_FAMILY_PSOC3, 1
.set CYDEV_CHIP_FAMILY_PSOC4, 2
.set CYDEV_CHIP_FAMILY_PSOC5, 3
.set CYDEV_CHIP_FAMILY_UNKNOWN, 0
.set CYDEV_CHIP_FAMILY_USED, CYDEV_CHIP_FAMILY_PSOC5
.set CYDEV_CHIP_JTAG_ID, 0x2E161069
.set CYDEV_CHIP_MEMBER_3A, 1
.set CYDEV_CHIP_MEMBER_4A, 10
.set CYDEV_CHIP_MEMBER_4C, 15
.set CYDEV_CHIP_MEMBER_4D, 6
.set CYDEV_CHIP_MEMBER_4E, 4
.set CYDEV_CHIP_MEMBER_4F, 11
.set CYDEV_CHIP_MEMBER_4G, 2
.set CYDEV_CHIP_MEMBER_4H, 9
.set CYDEV_CHIP_MEMBER_4I, 14
.set CYDEV_CHIP_MEMBER_4J, 7
.set CYDEV_CHIP_MEMBER_4K, 8
.set CYDEV_CHIP_MEMBER_4L, 13
.set CYDEV_CHIP_MEMBER_4M, 12
.set CYDEV_CHIP_MEMBER_4N, 5
.set CYDEV_CHIP_MEMBER_4U, 3
.set CYDEV_CHIP_MEMBER_5A, 17
.set CYDEV_CHIP_MEMBER_5B, 16
.set CYDEV_CHIP_MEMBER_UNKNOWN, 0
.set CYDEV_CHIP_MEMBER_USED, CYDEV_CHIP_MEMBER_5B
.set CYDEV_CHIP_DIE_EXPECT, CYDEV_CHIP_MEMBER_USED
.set CYDEV_CHIP_DIE_ACTUAL, CYDEV_CHIP_DIE_EXPECT
.set CYDEV_CHIP_REV_LEOPARD_ES1, 0
.set CYDEV_CHIP_REV_LEOPARD_ES2, 1
.set CYDEV_CHIP_REV_LEOPARD_ES3, 3
.set CYDEV_CHIP_REV_LEOPARD_PRODUCTION, 3
.set CYDEV_CHIP_REV_PANTHER_ES0, 0
.set CYDEV_CHIP_REV_PANTHER_ES1, 1
.set CYDEV_CHIP_REV_PANTHER_PRODUCTION, 1
.set CYDEV_CHIP_REV_PSOC4A_ES0, 17
.set CYDEV_CHIP_REV_PSOC4A_PRODUCTION, 17
.set CYDEV_CHIP_REV_PSOC5LP_ES0, 0
.set CYDEV_CHIP_REV_PSOC5LP_PRODUCTION, 0
.set CYDEV_CHIP_REV_TMA4_ES, 17
.set CYDEV_CHIP_REV_TMA4_ES2, 33
.set CYDEV_CHIP_REV_TMA4_PRODUCTION, 17
.set CYDEV_CHIP_REVISION_3A_ES1, 0
.set CYDEV_CHIP_REVISION_3A_ES2, 1
.set CYDEV_CHIP_REVISION_3A_ES3, 3
.set CYDEV_CHIP_REVISION_3A_PRODUCTION, 3
.set CYDEV_CHIP_REVISION_4A_ES0, 17
.set CYDEV_CHIP_REVISION_4A_PRODUCTION, 17
.set CYDEV_CHIP_REVISION_4C_PRODUCTION, 0
.set CYDEV_CHIP_REVISION_4D_PRODUCTION, 0
.set CYDEV_CHIP_REVISION_4E_PRODUCTION, 0
.set CYDEV_CHIP_REVISION_4F_PRODUCTION, 0
.set CYDEV_CHIP_REVISION_4F_PRODUCTION_256DMA, 0
.set CYDEV_CHIP_REVISION_4F_PRODUCTION_256K, 0
.set CYDEV_CHIP_REVISION_4G_ES, 17
.set CYDEV_CHIP_REVISION_4G_ES2, 33
.set CYDEV_CHIP_REVISION_4G_PRODUCTION, 17
.set CYDEV_CHIP_REVISION_4H_PRODUCTION, 0
.set CYDEV_CHIP_REVISION_4I_PRODUCTION, 0
.set CYDEV_CHIP_REVISION_4J_PRODUCTION, 0
.set CYDEV_CHIP_REVISION_4K_PRODUCTION, 0
.set CYDEV_CHIP_REVISION_4L_PRODUCTION, 0
.set CYDEV_CHIP_REVISION_4M_PRODUCTION, 0
.set CYDEV_CHIP_REVISION_4N_PRODUCTION, 0
.set CYDEV_CHIP_REVISION_4U_PRODUCTION, 0
.set CYDEV_CHIP_REVISION_5A_ES0, 0
.set CYDEV_CHIP_REVISION_5A_ES1, 1
.set CYDEV_CHIP_REVISION_5A_PRODUCTION, 1
.set CYDEV_CHIP_REVISION_5B_ES0, 0
.set CYDEV_CHIP_REVISION_5B_PRODUCTION, 0
.set CYDEV_CHIP_REVISION_USED, CYDEV_CHIP_REVISION_5B_PRODUCTION
.set CYDEV_CHIP_REV_EXPECT, CYDEV_CHIP_REVISION_USED
.set CYDEV_CONFIG_FASTBOOT_ENABLED, 1
.set CYDEV_CONFIG_UNUSED_IO_AllowButWarn, 0
.set CYDEV_CONFIG_UNUSED_IO, CYDEV_CONFIG_UNUSED_IO_AllowButWarn
.set CYDEV_CONFIG_UNUSED_IO_AllowWithInfo, 1
.set CYDEV_CONFIG_UNUSED_IO_Disallowed, 2
.set CYDEV_CONFIGURATION_COMPRESSED, 1
.set CYDEV_CONFIGURATION_DMA, 0
.set CYDEV_CONFIGURATION_ECC, 1
.set CYDEV_CONFIGURATION_IMOENABLED, CYDEV_CONFIG_FASTBOOT_ENABLED
.set CYDEV_CONFIGURATION_MODE_COMPRESSED, 0
.set CYDEV_CONFIGURATION_MODE, CYDEV_CONFIGURATION_MODE_COMPRESSED
.set CYDEV_CONFIGURATION_MODE_DMA, 2
.set CYDEV_CONFIGURATION_MODE_UNCOMPRESSED, 1
.set CYDEV_DEBUG_ENABLE_MASK, 0x20
.set CYDEV_DEBUG_ENABLE_REGISTER, CYREG_MLOGIC_DEBUG
.set CYDEV_DEBUGGING_DPS_Disable, 3
.set CYDEV_DEBUGGING_DPS_JTAG_4, 1
.set CYDEV_DEBUGGING_DPS_JTAG_5, 0
.set CYDEV_DEBUGGING_DPS_SWD, 2
.set CYDEV_DEBUGGING_DPS_SWD_SWV, 6
.set CYDEV_DEBUGGING_DPS, CYDEV_DEBUGGING_DPS_SWD_SWV
.set CYDEV_DEBUGGING_ENABLE, 1
.set CYDEV_DEBUGGING_XRES, 0
.set CYDEV_DMA_CHANNELS_AVAILABLE, 24
.set CYDEV_ECC_ENABLE, 0
.set CYDEV_HEAP_SIZE, 0x80
.set CYDEV_INSTRUCT_CACHE_ENABLED, 1
.set CYDEV_INTR_RISING, 0x00000000
.set CYDEV_IS_EXPORTING_CODE, 0
.set CYDEV_IS_IMPORTING_CODE, 0
.set CYDEV_PROJ_TYPE, 0
.set CYDEV_PROJ_TYPE_BOOTLOADER, 1
.set CYDEV_PROJ_TYPE_LAUNCHER, 5
.set CYDEV_PROJ_TYPE_LOADABLE, 2
.set CYDEV_PROJ_TYPE_LOADABLEANDBOOTLOADER, 4
.set CYDEV_PROJ_TYPE_MULTIAPPBOOTLOADER, 3
.set CYDEV_PROJ_TYPE_STANDARD, 0
.set CYDEV_PROTECTION_ENABLE, 0
.set CYDEV_STACK_SIZE, 0x0800
.set CYDEV_USE_BUNDLED_CMSIS, 1
.set CYDEV_VARIABLE_VDDA, 0
.set CYDEV_VDDA_MV, 5000
.set CYDEV_VDDD_MV, 5000
.set CYDEV_VDDIO0_MV, 5000
.set CYDEV_VDDIO1_MV, 5000
.set CYDEV_VDDIO2_MV, 5000
.set CYDEV_VDDIO3_MV, 5000
.set CYDEV_VIO0_MV, 5000
.set CYDEV_VIO1_MV, 5000
.set CYDEV_VIO2_MV, 5000
.set CYDEV_VIO3_MV, 5000
.set CYIPBLOCK_ARM_CM3_VERSION, 0
.set CYIPBLOCK_P3_ANAIF_VERSION, 0
.set CYIPBLOCK_P3_CAN_VERSION, 0
.set CYIPBLOCK_P3_CAPSENSE_VERSION, 0
.set CYIPBLOCK_P3_COMP_VERSION, 0
.set CYIPBLOCK_P3_DECIMATOR_VERSION, 0
.set CYIPBLOCK_P3_DFB_VERSION, 0
.set CYIPBLOCK_P3_DMA_VERSION, 0
.set CYIPBLOCK_P3_DRQ_VERSION, 0
.set CYIPBLOCK_P3_DSM_VERSION, 0
.set CYIPBLOCK_P3_EMIF_VERSION, 0
.set CYIPBLOCK_P3_I2C_VERSION, 0
.set CYIPBLOCK_P3_LCD_VERSION, 0
.set CYIPBLOCK_P3_LPF_VERSION, 0
.set CYIPBLOCK_P3_OPAMP_VERSION, 0
.set CYIPBLOCK_P3_PM_VERSION, 0
.set CYIPBLOCK_P3_SCCT_VERSION, 0
.set CYIPBLOCK_P3_TIMER_VERSION, 0
.set CYIPBLOCK_P3_USB_VERSION, 0
.set CYIPBLOCK_P3_VIDAC_VERSION, 0
.set CYIPBLOCK_P3_VREF_VERSION, 0
.set CYIPBLOCK_S8_GPIO_VERSION, 0
.set CYIPBLOCK_S8_IRQ_VERSION, 0
.set CYIPBLOCK_S8_SAR_VERSION, 0
.set CYIPBLOCK_S8_SIO_VERSION, 0
.set CYIPBLOCK_S8_UDB_VERSION, 0
.set DMA_CHANNELS_USED__MASK0, 0x00000000
.set CYDEV_BOOTLOADER_ENABLE, 0
.endif
